## CMakeLists.txt
```
cmake_minimum_required(VERSION 3.20.0)
set(BOARD adafruit_feather_nrf52840) # added
find_package(Zephyr REQUIRED HINTS $ENV{ZEPHYR_BASE})

project(inputs)

target_sources(app PRIVATE 
    src/main.c
    src/test.c
    #src/test_spim.c
)
```

## prj.conf
```kconfig
CONFIG_NRFX_PWM2=y
CONFIG_NRFX_SPIM1=y
CONFIG_GPIO=n
CONFIG_NRFX_GPIOTE0=y
CONFIG_NRFX_TIMER0=y
CONFIG_NRFX_TIMER1=y
CONFIG_NRFX_PPI=y
CONFIG_ZERO_LATENCY_IRQS=y
CONFIG_NRFX_EGU0=y
#CONFIG_CODE_DATA_RELOCATION=y

CONFIG_ASSERT=y 

CONFIG_LOG_MODE_IMMEDIATE=y 


# RTT 
CONFIG_LOG=y
CONFIG_USE_SEGGER_RTT=y
CONFIG_LOG_BACKEND_UART=n
CONFIG_LOG_BACKEND_RTT=y
```

## src/main.c
```c
#include <zephyr/kernel.h>

#include <nrfx_gpiote.h> 
#include <nrfx_timer.h>
#include <hal/nrf_ppi.h>
#include <hal/nrf_gpio.h>
#include <nrfx_spim.h>
#include <zephyr/logging/log.h>
#include <zephyr/irq.h>
#include <hal/nrf_egu.h>
#include "test.h" 
//#include "test_spim.h"
//#include <nrfx_pwm.h>
LOG_MODULE_REGISTER(inputs, LOG_LEVEL_INF);

// pin configurations 
#define SRAMOUT_CLK_IN 27
#define SRAMOUT_DATA_IN 26
#define DATAOUT_CLK_IN 14
#define DATAOUT_DATA_IN 13

// hardware index 
#define GPIOTE_INST_IDX 0
#define TIMER_SRAMOUT_INST_IDX 0
#define TIMER_DATAOUT_INST_IDX 1

// hardware instances 
//#define GPIOTE_NODE DT_NODELABEL(gpiote0)
//static nrfx_gpiote_t gpiote_inst = NRFX_GPIOTE_INSTANCE(GPIOTE_INST_IDX);

static const nrfx_timer_t timer_sramout_inst = NRFX_TIMER_INSTANCE(TIMER_SRAMOUT_INST_IDX); 
static const nrfx_timer_t timer_dataout_inst = NRFX_TIMER_INSTANCE(TIMER_DATAOUT_INST_IDX);

// channels 
#define GPIOTE_SRAMOUT_CH 1
#define GPIOTE_DATAOUT_CH 2
#define PPI_SRAMOUT_CH NRF_PPI_CHANNEL0 
#define PPI_DATAOUT_CH NRF_PPI_CHANNEL1
#define PPI_EGU_CH NRF_PPI_CHANNEL2

// pin mask 
#define SRAMOUT_PIN_MASK (1 << SRAMOUT_DATA_IN)
#define DATAOUT_PIN_MASK (1 << DATAOUT_DATA_IN)

// global variables 
//volatile uint32_t sramout_buffer = 0; 
volatile uint32_t sramout_buffer[4];
volatile uint32_t dataout_buffer = 0; 
volatile int sramout_count = 0;
volatile int dataout_count = 0; 
volatile bool sramout_ready = false; 
volatile bool dataout_ready = false;

// https://docs.zephyrproject.org/latest/kernel/services/interrupts.html 
// __attribute__((section(".ramfunc")))
// ISR_DIRECT_DECLARE(gpiote_fast_handler)
// {
//     NRF_GPIOTE->EVENTS_IN[1] = 0;

//     if (NRF_P0->IN & (1 << SRAMOUT_DATA_IN)) {
//         sramout_buffer |= (1 << sramout_count);
//     }
//     sramout_count++;

//     return 0;
// }

uint32_t b[4];
volatile uint32_t *capture_ptr; 
volatile uint32_t raw_capture[113];

__attribute__((section(".ramfunc")))
ISR_DIRECT_DECLARE(gpiote_fast_handler)
{
//     NRF_GPIOTE->EVENTS_IN[1] = 0;
//     uint32_t pin_state = NRF_P0->IN;

//     if (sramout_count < 64) {
//         if ((pin_state >> SRAMOUT_DATA_IN) & 1) {
//             part1 |= ((uint64_t)1 << sramout_count);
//         }
//     } else if (sramout_count < 128) {
//         if ((pin_state >> SRAMOUT_DATA_IN) & 1) {
//             part2 |= ((uint64_t)1 << (sramout_count - 64));
//         }
//     }

//     sramout_count++;
//     return 0;

        // 1. SNAPSHOT FIRST (Cycle 0)
        uint32_t val = NRF_P0->IN; 

        // 2. Clear hardware event
        NRF_GPIOTE->EVENTS_IN[1] = 0;

        // 3. Simple Store (The CPU loves this)
        *capture_ptr++ = val;
        sramout_count++;

        __DSB();
        return 1;

}

__attribute__((section(".ramfunc")))
ISR_DIRECT_DECLARE(egu_fast_handler) {
    NRF_GPIOTE->EVENTS_IN[2] = 0;
    NRF_EGU0->EVENTS_TRIGGERED[0] = 0;

    if (NRF_P0->IN & (1 << DATAOUT_DATA_IN)) {
        dataout_buffer |= (1 << dataout_count);
    }
    dataout_count++;
    return 0;
}

void timer_sramout_handler(nrf_timer_event_t event_type, void * p_context) {
        if (event_type == NRF_TIMER_EVENT_COMPARE0) {
        // packet is finished 
                if (sramout_count > 0) {
                sramout_ready = true;
                }
        }
}

void timer_dataout_handler(nrf_timer_event_t event_type, void * p_context) {
        if (event_type == NRF_TIMER_EVENT_COMPARE0) {
        // packet is finished 
                if (dataout_count > 0) {
                dataout_ready = true;
                }
        }
}

static void gpiote_init(void) {

        // enable instruction cache
        NRF_NVMC->ICACHECNF = NVMC_ICACHECNF_CACHEEN_Enabled << NVMC_ICACHECNF_CACHEEN_Pos;

        IRQ_DIRECT_CONNECT(GPIOTE_IRQn, 0, gpiote_fast_handler, IRQ_ZERO_LATENCY);
        irq_enable(GPIOTE_IRQn);

        IRQ_DIRECT_CONNECT(SWI0_EGU0_IRQn, 0, egu_fast_handler, IRQ_ZERO_LATENCY);
        irq_enable(SWI0_EGU0_IRQn);

        // sramout channel 
        NRF_GPIOTE->CONFIG[1] = (GPIOTE_CONFIG_MODE_Event      << GPIOTE_CONFIG_MODE_Pos)   |
                            (SRAMOUT_CLK_IN                        << GPIOTE_CONFIG_PSEL_Pos)   |
                            (GPIOTE_CONFIG_POLARITY_LoToHi << GPIOTE_CONFIG_POLARITY_Pos);

        NRF_GPIOTE->INTENSET = GPIOTE_INTENSET_IN1_Msk;

        nrf_gpio_cfg_input(SRAMOUT_DATA_IN, NRF_GPIO_PIN_NOPULL);

        // egu for dataout 
        NRF_EGU0->EVENTS_TRIGGERED[0] = 0;
        NRF_EGU0->INTENSET = EGU_INTENSET_TRIGGERED0_Msk;

        // dataout channel 
        NRF_GPIOTE->CONFIG[2] = (GPIOTE_CONFIG_MODE_Event      << GPIOTE_CONFIG_MODE_Pos)   |
                            (DATAOUT_CLK_IN                        << GPIOTE_CONFIG_PSEL_Pos)   |
                            (GPIOTE_CONFIG_POLARITY_LoToHi << GPIOTE_CONFIG_POLARITY_Pos);
        
        NRF_GPIOTE->INTENCLR = GPIOTE_INTENCLR_IN2_Msk;

        nrf_gpio_cfg_input(DATAOUT_DATA_IN, NRF_GPIO_PIN_NOPULL);

        // connect dataout with egu 
        nrf_ppi_channel_endpoint_setup(NRF_PPI, PPI_EGU_CH, 
                (uint32_t)&NRF_GPIOTE->EVENTS_IN[2], 
                (uint32_t)&NRF_EGU0->TASKS_TRIGGER[0]
        ); 

        nrf_ppi_channel_enable(NRF_PPI, PPI_EGU_CH);

} 

static void timer_init(void) {
        IRQ_CONNECT(NRFX_IRQ_NUMBER_GET(NRF_TIMER_INST_GET(TIMER_SRAMOUT_INST_IDX)), IRQ_PRIO_LOWEST,
                NRFX_TIMER_INST_HANDLER_GET(TIMER_SRAMOUT_INST_IDX), 0, 0);
        
        IRQ_CONNECT(NRFX_IRQ_NUMBER_GET(NRF_TIMER_INST_GET(TIMER_DATAOUT_INST_IDX)), IRQ_PRIO_LOWEST,
                NRFX_TIMER_INST_HANDLER_GET(TIMER_DATAOUT_INST_IDX), 0, 0);

        // sramout timeout 
        uint32_t base_frequency = NRF_TIMER_BASE_FREQUENCY_GET(timer_sramout_inst.p_reg);
        nrfx_timer_config_t sramout_config = NRFX_TIMER_DEFAULT_CONFIG(base_frequency);
        sramout_config.bit_width = NRF_TIMER_BIT_WIDTH_32;
        
        nrfx_err_t err = nrfx_timer_init(&timer_sramout_inst, &sramout_config, timer_sramout_handler); 
        if (err != NRFX_SUCCESS) {
                LOG_INF("sramout timer init failed");
        }
        LOG_INF("sramout timer init succeeded");
        
        nrfx_timer_clear(&timer_sramout_inst);

        uint32_t desired_ticks = nrfx_timer_us_to_ticks(&timer_sramout_inst, 5000000); // 1s
        nrfx_timer_extended_compare(&timer_sramout_inst, NRF_TIMER_CC_CHANNEL0, desired_ticks,
                                NRF_TIMER_SHORT_COMPARE0_STOP_MASK, true);

        // turn timer off initially 
        nrf_timer_task_trigger(timer_sramout_inst.p_reg, NRF_TIMER_TASK_STOP);
        nrf_timer_task_trigger(timer_sramout_inst.p_reg, NRF_TIMER_TASK_CLEAR);

        // dataout timeout 
        base_frequency = NRF_TIMER_BASE_FREQUENCY_GET(timer_dataout_inst.p_reg);
        nrfx_timer_config_t dataout_config = NRFX_TIMER_DEFAULT_CONFIG(base_frequency);
        dataout_config.bit_width = NRF_TIMER_BIT_WIDTH_32;
        
        err = nrfx_timer_init(&timer_dataout_inst, &dataout_config, timer_dataout_handler); 
        if (err != NRFX_SUCCESS) {
                LOG_INF("dataout timer init failed");
        }
        LOG_INF("dataout timer init succeeded");
        
        nrfx_timer_clear(&timer_dataout_inst);

        desired_ticks = nrfx_timer_us_to_ticks(&timer_dataout_inst, 9000000); // 1s
        nrfx_timer_extended_compare(&timer_dataout_inst, NRF_TIMER_CC_CHANNEL0, desired_ticks,
                                NRF_TIMER_SHORT_COMPARE0_STOP_MASK, true);

        // turn timer off initially 
        nrf_timer_task_trigger(timer_dataout_inst.p_reg, NRF_TIMER_TASK_STOP);
        nrf_timer_task_trigger(timer_dataout_inst.p_reg, NRF_TIMER_TASK_CLEAR);
} 

static void ppi_init(void) {
        // low to high --> start timer 
        nrf_ppi_channel_endpoint_setup(NRF_PPI, PPI_SRAMOUT_CH, 
                (uint32_t)&NRF_GPIOTE->EVENTS_IN[1], 
                nrfx_timer_task_address_get(&timer_sramout_inst, NRF_TIMER_TASK_CLEAR)
        ); 

        // low to high --> clear timer 
        nrf_ppi_fork_endpoint_setup(NRF_PPI, PPI_SRAMOUT_CH, nrfx_timer_task_address_get(&timer_sramout_inst, NRF_TIMER_TASK_START)); 

        nrf_ppi_channel_enable(NRF_PPI, PPI_SRAMOUT_CH); 

        // low to high --> start timer 
        nrf_ppi_channel_endpoint_setup(NRF_PPI, PPI_DATAOUT_CH, 
                (uint32_t)&NRF_GPIOTE->EVENTS_IN[2], 
                nrfx_timer_task_address_get(&timer_dataout_inst, NRF_TIMER_TASK_CLEAR)
        ); 

        // low to high --> clear timer 
        nrf_ppi_fork_endpoint_setup(NRF_PPI, PPI_DATAOUT_CH, nrfx_timer_task_address_get(&timer_dataout_inst, NRF_TIMER_TASK_START)); 

        nrf_ppi_channel_enable(NRF_PPI, PPI_DATAOUT_CH);
}

void process_capture_to_b4(void) {
    // 1. Clear the destination buffer first!
    memset(b, 0, sizeof(b));

    for (int i = 0; i < 113; i++) {
        // 2. Extract ONLY bit 26 from the i-th snapshot
        uint32_t bit = (raw_capture[i] >> 26) & 1;

        // 3. Pack the bit into b[4]
        // (i >> 5) selects the word: 0, 1, 2, or 3
        // (i & 31) selects the bit position inside that word
        if (bit) {
            b[i >> 5] |= (1U << (i & 31));
        }
    }
}

void print_b4_hex(void) {
    LOG_INF("b[4] Data (Hex): ");
    for (int i = 0; i < 4; i++) {
        LOG_INF("0x%08X ", b[i]);
    }
}

int main(void)
{       
        // initialize hardware 
        gpiote_init(); 

        timer_init(); 

        ppi_init(); 
        
        // uint8_t my_sipo_data[16] = {
        //         0xAA, 0x55, 0xAA, 0x55, // Bytes 0-3
        //         0xAA, 0x55, 0xAA, 0x55, // Bytes 4-7
        //         0xAA, 0x55, 0xAA, 0x55, // Bytes 8-11
        //         0xAA, 0x55, 0xAA, 0x55  // Bytes 12-15
        // };

        // uint8_t my_sipo_data[16] = {
        //         0xAA, 0x55, 0xAA, 0x55, // Bytes 0-3
        //         0xAA, 0x55, 0xAA, 0x55,
        //         0xAA, 0x55, 0xAA, 0x55,
        //         0xAA, 0x55, 0xAA, 0x55
        // };

        // uint8_t my_sipo_data[4] = {
        //         0xAA, 0x55, 0xAA, 0x55 // Bytes 0-3
        // };

        uint8_t my_sipo_data[16] = {0xFF, 0x00, 0xAA, 0x88, 0xAA, 0x00, 0x00, 0x00, 0xFF, 0x00, 0x00, 0x00, 0xFF, 0x00, 0x00, 0x00};

        capture_ptr = &raw_capture[0];

        // initialize test 
        buffer_init(my_sipo_data); 

        pwm_init();

        k_msleep(100);

        sramout_count = 0;
        nrfx_pwm_simple_playback(&pwm_instance, &seq, 1, NRFX_PWM_FLAG_STOP);

        while(!pwm_done) {k_usleep(10);}

        while (!sramout_ready){ 
               k_msleep(1);  
        }

        process_capture_to_b4(); 

        print_b4_hex(); 
        LOG_INF("Total Bits Captured: %d", sramout_count);

        //LOG_INF("sramout: 0x%08X (Bits: %d)\n", sramout_buffer, sramout_count);

}
```

## src/main_spim.c
```c
#include <zephyr/kernel.h>

#include <nrfx_gpiote.h> 
#include <nrfx_timer.h>
#include <hal/nrf_ppi.h>
#include <hal/nrf_gpio.h>
#include <nrfx_spim.h>
#include <zephyr/logging/log.h>
#include <zephyr/irq.h>
#include <hal/nrf_egu.h>
//#include "test.h" 
#include "test_spim.h"
//#include <nrfx_pwm.h>
LOG_MODULE_REGISTER(inputs, LOG_LEVEL_INF);

// pin configurations 
#define SRAMOUT_CLK_IN 27
#define SRAMOUT_DATA_IN 26
#define DATAOUT_CLK_IN 23
#define DATAOUT_DATA_IN 22

// hardware index 
#define GPIOTE_INST_IDX 0
#define TIMER_SRAMOUT_INST_IDX 0
#define TIMER_DATAOUT_INST_IDX 1

// hardware instances 
//#define GPIOTE_NODE DT_NODELABEL(gpiote0)
//static nrfx_gpiote_t gpiote_inst = NRFX_GPIOTE_INSTANCE(GPIOTE_INST_IDX);

static const nrfx_timer_t timer_sramout_inst = NRFX_TIMER_INSTANCE(TIMER_SRAMOUT_INST_IDX); 
static const nrfx_timer_t timer_dataout_inst = NRFX_TIMER_INSTANCE(TIMER_DATAOUT_INST_IDX);

// channels 
#define GPIOTE_SRAMOUT_CH 1
#define GPIOTE_DATAOUT_CH 2
#define PPI_SRAMOUT_CH NRF_PPI_CHANNEL0 
#define PPI_DATAOUT_CH NRF_PPI_CHANNEL1
#define PPI_EGU_CH NRF_PPI_CHANNEL2

// pin mask 
#define SRAMOUT_PIN_MASK (1 << SRAMOUT_DATA_IN)
#define DATAOUT_PIN_MASK (1 << DATAOUT_DATA_IN)

// global variables 
volatile uint32_t sramout_buffer = 0; 
volatile uint32_t dataout_buffer = 0; 
volatile int sramout_count = 0;
volatile int dataout_count = 0; 
volatile bool sramout_ready = false; 
volatile bool dataout_ready = false;

// https://docs.zephyrproject.org/latest/kernel/services/interrupts.html 
__attribute__((section(".ramfunc")))
ISR_DIRECT_DECLARE(gpiote_fast_handler)
{
    NRF_GPIOTE->EVENTS_IN[1] = 0;

    if (NRF_P0->IN & (1 << SRAMOUT_DATA_IN)) {
        sramout_buffer |= (1 << sramout_count);
    }
    sramout_count++;

    return 0;
}

__attribute__((section(".ramfunc")))
ISR_DIRECT_DECLARE(egu_fast_handler) {
    NRF_GPIOTE->EVENTS_IN[2] = 0;
    NRF_EGU0->EVENTS_TRIGGERED[0] = 0;

    if (NRF_P0->IN & (1 << DATAOUT_DATA_IN)) {
        dataout_buffer |= (1 << dataout_count);
    }
    dataout_count++;
    return 0;
}

void timer_sramout_handler(nrf_timer_event_t event_type, void * p_context) {
        if (event_type == NRF_TIMER_EVENT_COMPARE0) {
        // packet is finished 
                if (sramout_count > 0) {
                sramout_ready = true;
                }
        }
}

void timer_dataout_handler(nrf_timer_event_t event_type, void * p_context) {
        if (event_type == NRF_TIMER_EVENT_COMPARE0) {
        // packet is finished 
                if (dataout_count > 0) {
                dataout_ready = true;
                }
        }
}

static void gpiote_init(void) {

        // enable instruction cache
        NRF_NVMC->ICACHECNF = NVMC_ICACHECNF_CACHEEN_Enabled << NVMC_ICACHECNF_CACHEEN_Pos;

        IRQ_DIRECT_CONNECT(GPIOTE_IRQn, 0, gpiote_fast_handler, IRQ_ZERO_LATENCY);
        irq_enable(GPIOTE_IRQn);

        IRQ_DIRECT_CONNECT(SWI0_EGU0_IRQn, 0, egu_fast_handler, IRQ_ZERO_LATENCY);
        irq_enable(SWI0_EGU0_IRQn);

        // sramout channel 
        NRF_GPIOTE->CONFIG[1] = (GPIOTE_CONFIG_MODE_Event      << GPIOTE_CONFIG_MODE_Pos)   |
                            (SRAMOUT_CLK_IN                        << GPIOTE_CONFIG_PSEL_Pos)   |
                            (GPIOTE_CONFIG_POLARITY_LoToHi << GPIOTE_CONFIG_POLARITY_Pos);

        NRF_GPIOTE->INTENSET = GPIOTE_INTENSET_IN1_Msk;

        nrf_gpio_cfg_input(SRAMOUT_DATA_IN, NRF_GPIO_PIN_NOPULL);

        // egu for dataout 
        NRF_EGU0->EVENTS_TRIGGERED[0] = 0;
        NRF_EGU0->INTENSET = EGU_INTENSET_TRIGGERED0_Msk;

        // dataout channel 
        NRF_GPIOTE->CONFIG[2] = (GPIOTE_CONFIG_MODE_Event      << GPIOTE_CONFIG_MODE_Pos)   |
                            (DATAOUT_CLK_IN                        << GPIOTE_CONFIG_PSEL_Pos)   |
                            (GPIOTE_CONFIG_POLARITY_LoToHi << GPIOTE_CONFIG_POLARITY_Pos);
        
        NRF_GPIOTE->INTENCLR = GPIOTE_INTENCLR_IN2_Msk;

        nrf_gpio_cfg_input(DATAOUT_DATA_IN, NRF_GPIO_PIN_NOPULL);

        // connect dataout with egu 
        nrf_ppi_channel_endpoint_setup(NRF_PPI, PPI_EGU_CH, 
                (uint32_t)&NRF_GPIOTE->EVENTS_IN[2], 
                (uint32_t)&NRF_EGU0->TASKS_TRIGGER[0]
        ); 

        nrf_ppi_channel_enable(NRF_PPI, PPI_EGU_CH);

} 

static void timer_init(void) {
        IRQ_CONNECT(NRFX_IRQ_NUMBER_GET(NRF_TIMER_INST_GET(TIMER_SRAMOUT_INST_IDX)), IRQ_PRIO_LOWEST,
                NRFX_TIMER_INST_HANDLER_GET(TIMER_SRAMOUT_INST_IDX), 0, 0);
        
        IRQ_CONNECT(NRFX_IRQ_NUMBER_GET(NRF_TIMER_INST_GET(TIMER_DATAOUT_INST_IDX)), IRQ_PRIO_LOWEST,
                NRFX_TIMER_INST_HANDLER_GET(TIMER_DATAOUT_INST_IDX), 0, 0);

        // sramout timeout 
        uint32_t base_frequency = NRF_TIMER_BASE_FREQUENCY_GET(timer_sramout_inst.p_reg);
        nrfx_timer_config_t sramout_config = NRFX_TIMER_DEFAULT_CONFIG(base_frequency);
        sramout_config.bit_width = NRF_TIMER_BIT_WIDTH_32;
        
        nrfx_err_t err = nrfx_timer_init(&timer_sramout_inst, &sramout_config, timer_sramout_handler); 
        if (err != NRFX_SUCCESS) {
                LOG_INF("sramout timer init failed");
        }
        LOG_INF("sramout timer init succeeded");
        
        nrfx_timer_clear(&timer_sramout_inst);

        uint32_t desired_ticks = nrfx_timer_us_to_ticks(&timer_sramout_inst, 5000000); // 1s
        nrfx_timer_extended_compare(&timer_sramout_inst, NRF_TIMER_CC_CHANNEL0, desired_ticks,
                                NRF_TIMER_SHORT_COMPARE0_STOP_MASK, true);

        // turn timer off initially 
        nrf_timer_task_trigger(timer_sramout_inst.p_reg, NRF_TIMER_TASK_STOP);
        nrf_timer_task_trigger(timer_sramout_inst.p_reg, NRF_TIMER_TASK_CLEAR);

        // dataout timeout 
        base_frequency = NRF_TIMER_BASE_FREQUENCY_GET(timer_dataout_inst.p_reg);
        nrfx_timer_config_t dataout_config = NRFX_TIMER_DEFAULT_CONFIG(base_frequency);
        dataout_config.bit_width = NRF_TIMER_BIT_WIDTH_32;
        
        err = nrfx_timer_init(&timer_dataout_inst, &dataout_config, timer_dataout_handler); 
        if (err != NRFX_SUCCESS) {
                LOG_INF("dataout timer init failed");
        }
        LOG_INF("dataout timer init succeeded");
        
        nrfx_timer_clear(&timer_dataout_inst);

        desired_ticks = nrfx_timer_us_to_ticks(&timer_dataout_inst, 5000000); // 1s
        nrfx_timer_extended_compare(&timer_dataout_inst, NRF_TIMER_CC_CHANNEL0, desired_ticks,
                                NRF_TIMER_SHORT_COMPARE0_STOP_MASK, true);

        // turn timer off initially 
        nrf_timer_task_trigger(timer_dataout_inst.p_reg, NRF_TIMER_TASK_STOP);
        nrf_timer_task_trigger(timer_dataout_inst.p_reg, NRF_TIMER_TASK_CLEAR);
} 

static void ppi_init(void) {
        // low to high --> start timer 
        nrf_ppi_channel_endpoint_setup(NRF_PPI, PPI_SRAMOUT_CH, 
                (uint32_t)&NRF_GPIOTE->EVENTS_IN[1], 
                nrfx_timer_task_address_get(&timer_sramout_inst, NRF_TIMER_TASK_CLEAR)
        ); 

        // low to high --> clear timer 
        nrf_ppi_fork_endpoint_setup(NRF_PPI, PPI_SRAMOUT_CH, nrfx_timer_task_address_get(&timer_sramout_inst, NRF_TIMER_TASK_START)); 

        nrf_ppi_channel_enable(NRF_PPI, PPI_SRAMOUT_CH); 

        // low to high --> start timer 
        nrf_ppi_channel_endpoint_setup(NRF_PPI, PPI_DATAOUT_CH, 
                (uint32_t)&NRF_GPIOTE->EVENTS_IN[2], 
                nrfx_timer_task_address_get(&timer_dataout_inst, NRF_TIMER_TASK_CLEAR)
        ); 

        // low to high --> clear timer 
        nrf_ppi_fork_endpoint_setup(NRF_PPI, PPI_DATAOUT_CH, nrfx_timer_task_address_get(&timer_dataout_inst, NRF_TIMER_TASK_START)); 

        nrf_ppi_channel_enable(NRF_PPI, PPI_DATAOUT_CH);
}

int main(void)
{       
        // initialize hardware 
        gpiote_init(); 

        timer_init(); 

        ppi_init(); 

        // initialize test 
        //buffer_init(); 

        //pwm_init();

        k_msleep(50);

        //nrfx_pwm_simple_playback(&pwm_instance, &seq, 1, NRFX_PWM_FLAG_STOP);

        spim_init(); 

        // xfer start 
        nrfx_spim_xfer_desc_t xfer = {
                .p_tx_buffer = tx_buf,
                .tx_length   = sizeof(tx_buf),
                .p_rx_buffer = NULL,
                .rx_length   = 0
        };

        spim_done = false;

        nrfx_err_t err = nrfx_spim_xfer(&spim_inst, &xfer, 0);
        if (err != NRFX_SUCCESS) {
                LOG_INF("SPIM xfer failed"); 
        }

        LOG_INF("SPIM xfer succeeded");

        while(!spim_done) {k_usleep(10);}

        while (!sramout_ready){ 
               k_msleep(1);  
        }
        LOG_INF("sramout: 0x%08X (Bits: %d)\n", sramout_buffer, sramout_count);

}
```

## src/test.c
```c
#include "test.h" 
#include <zephyr/irq.h>
#include <zephyr/logging/log.h>


//LOG_MODULE_REGISTER(inputs, LOG_LEVEL_INF);

/**
 * @defgroup nrfx_pwm_grouped_example Grouped mode PWM example
 * @{
 * @ingroup nrfx_pwm_examples
 *
 * @brief Example showing basic functionality of nrfx_pwm driver for sequences loaded in grouped
 *        mode.
 *
 * @details Application initializes nrfx_pmw driver. It starts two-sequence playback on LEDs and
 *          replays this sequence @ref NUM_OF_LOOPS times. The @ref pwm_handler() is executed with
 *          relevant log message after every loop. Additionally, it changes SEQ1 each time it is
 *          called.
 */


/** @brief Symbol specifying PWM instance to be used. */
#define PWM_INST_IDX 2

// pwm instance 
nrfx_pwm_t pwm_instance = NRFX_PWM_INSTANCE(PWM_INST_IDX); 

// global variables 
bool pwm_done = false; 

/**
 * @brief Sequence default configuration in NRF_PWM_LOAD_GROUPED mode.
 *
 * This configuration sets up sequence with the following options:
 * - end delay: 0 PWM periods
 * - length: actual number of 16-bit values in the array pointed by @p _pwm_val
 * - repeats: VALUE_REPEATS
 *
 * @param[in] _pwm_val pointer to an array with duty cycle values.
 */
// #define SEQ_CONFIG(_pwm_val)                            \
// {                                                       \
//     .values.p_grouped = _pwm_val,                       \
//     .length           = 2 * NRFX_ARRAY_SIZE(_pwm_val),  \
//     .repeats          = VALUE_REPEATS,                  \
//     .end_delay        = 0                               \
// }

// buffer 
nrf_pwm_values_grouped_t m_duty_cycles[113]; 

/** @brief Array containing sequences to be used in this example. */
// static nrf_pwm_sequence_t seq[] =
// {
//     SEQ_CONFIG(m_duty_cycles)
// };

// Set length to 40 (20 bits * 2 values per bit)
nrf_pwm_sequence_t seq =
{
    .values.p_grouped = m_duty_cycles,
    .length           = 226, 
    .repeats          = 0,
    .end_delay        = 0
};

/**
 * @brief Function for handling PWM driver events.
 *
 * @param[in] event_type PWM event.
 * @param[in] p_context  General purpose parameter set during initialization of
 *                       the timer. This parameter can be used to pass
 *                       additional information to the handler function.
 */
void pwm_handler(nrfx_pwm_evt_type_t event_type, void * p_context)
{
        if (event_type == NRFX_PWM_EVT_FINISHED) pwm_done = true;  
} 

void pwm_init(void) {
        IRQ_CONNECT(NRFX_IRQ_NUMBER_GET(NRF_PWM_INST_GET(PWM_INST_IDX)), IRQ_PRIO_LOWEST,
                NRFX_PWM_INST_HANDLER_GET(PWM_INST_IDX), 0, 0);

        nrfx_err_t status;
        (void)status;

        nrfx_pwm_config_t config = NRFX_PWM_DEFAULT_CONFIG(CLK_OUT, NRF_PWM_PIN_NOT_CONNECTED, DATA_OUT, NRF_PWM_PIN_NOT_CONNECTED);
        config.base_clock = NRF_PWM_CLK_4MHz; 
        config.top_value = 16; 
        config.load_mode = NRF_PWM_LOAD_GROUPED;
        status = nrfx_pwm_init(&pwm_instance, &config, pwm_handler, NULL);
        NRFX_ASSERT(status == NRFX_SUCCESS);
} 

// void buffer_init(void) {
//         uint32_t data_value = 0x8888AAAA9999999999999999999999 99 99; 

//         for (uint8_t i = 0; i < 32; i++) {
//                 // Extract bit from MSB down to LSB
//                 bool bit = (data_value >> i) & 0x01;
 
//                 /// Data:
//                 if (!bit) {
//                         // Force "Always High" by setting duty cycle > top_value
//                         // This prevents the PWM counter from ever "resetting" the pin
//                         m_duty_cycles[i].group_1 = 0x8000; 
//                 } else {
//                         m_duty_cycles[i].group_1 = 0;  
//                 }

//                 m_duty_cycles[i].group_0 = 8;
//         }
// }

/* sipo functions */
void buffer_init(const uint8_t *sipo_data) {
        //uint32_t data_value = 0x88888; 

        // uint8_t data_value[16] = {
        //     0xAA, 0xAA, 0xAA, 0xAA, // Bytes 0-3  (101010...)
        //     0x55, 0x55, 0x55, 0x55, // Bytes 4-7  (010101...)
        //     0xFF, 0xFF, 0x00, 0x00, // Bytes 8-11 (Solid High then Solid Low)
        //     0x12, 0x34, 0x56, 0x78  // Bytes 12-15 (Random Pattern)
        // };

        for (uint8_t i = 0; i < 113; i++) {
                // Extract bit from MSB down to LSB
                //bool bit = (data_value >> (20 - 1 - i)) & 0x01;

                // 1. Calculate which byte we are in (0 to 15)
                int byte_idx = i / 8;
                
                // 2. Calculate which bit inside that byte (7 down to 0 for MSB-first)
                //int bit_idx = 7 - (i % 8);
                int bit_idx = (i % 8);

                // 3. Extract the bit
                bool bit = (sipo_data[byte_idx] >> bit_idx) & 0x01;

                /// Data:
                if (!bit) {
                        // Force "Always High" by setting duty cycle > top_value
                        // This prevents the PWM counter from ever "resetting" the pin
                        m_duty_cycles[i].group_1 = 16; 
                } else {
                        m_duty_cycles[i].group_1 = 0;  
                }

                m_duty_cycles[i].group_0 = 8;
        }
}
```

## src/test.h
```c
#ifndef TEST_H
#define TEST_H

#include <zephyr/kernel.h>
#include <nrfx_pwm.h>

// pins     
#define CLK_OUT 14
#define DATA_OUT 13 

/* * Function Prototypes
 * This allows main.c to "see" the functions defined in test.c
 */

/** @brief Initializes the PWM peripheral and connects interrupts */
void pwm_init(void);

/** @brief Fills the duty cycle buffer with 20-bit data */
void buffer_init(const uint8_t *sipo_data);

/* * Extern Variables
 * If you need to check the status of 'pwm_done' in your main loop
 */
extern bool pwm_done;
extern nrf_pwm_sequence_t seq;
extern nrfx_pwm_t pwm_instance;

#endif // TEST_H
```

## src/test_spim.c
```c
#include <zephyr/logging/log.h>
#include <zephyr/irq.h>
#include "test_spim.h" 

LOG_MODULE_DECLARE(inputs, LOG_LEVEL_INF);

#define SPIM_INST_IDX 1
const nrfx_spim_t spim_inst = NRFX_SPIM_INSTANCE(SPIM_INST_IDX);

volatile bool spim_done = false; 

// data buffers 
uint8_t tx_buf[4] = {
    0x88, 0x88, 0xAA, 0xAA  // 10001000 8 bits 
}; 

void spim_handler(nrfx_spim_evt_t const * p_event, void * p_context){
        if (p_event->type == NRFX_SPIM_EVENT_DONE)
        {
                spim_done = true; 
        }
} 

void spim_init(void) {
        IRQ_CONNECT(NRFX_IRQ_NUMBER_GET(NRF_SPIM_INST_GET(SPIM_INST_IDX)), IRQ_PRIO_LOWEST,NRFX_SPIM_INST_HANDLER_GET(SPIM_INST_IDX),
            0,
            0
        );
        nrfx_spim_config_t cfg = NRFX_SPIM_DEFAULT_CONFIG(CLK_OUT, DATA_OUT, NRF_SPIM_PIN_NOT_CONNECTED, NRF_SPIM_PIN_NOT_CONNECTED);

        cfg.frequency = NRFX_MHZ_TO_HZ(1);       // 1 MHz
        cfg.mode      = NRF_SPIM_MODE_0;         // CPOL=0, CPHA=0
        cfg.bit_order = NRF_SPIM_BIT_ORDER_MSB_FIRST;

        nrfx_err_t err = nrfx_spim_init(&spim_inst, &cfg, spim_handler, NULL);
        if (err != NRFX_SUCCESS) {
                 LOG_INF("SPIM init failed");
        }
        LOG_INF("SPIM initialized");

}
```

## src/test_spim.h
```c
#ifndef TEST_SPIM_H
#define TEST_SPIM_H

#include <zephyr/kernel.h>
#include <nrfx_spim.h>

#define CLK_OUT 14
#define DATA_OUT 13

// Share these with main.c
extern const nrfx_spim_t spim_inst;
extern volatile bool spim_done;
extern uint8_t tx_buf[4];

void spim_init(void);
void spim_handler(nrfx_spim_evt_t const * p_event, void * p_context);

#endif
```
