## CMakeLists.txt
```
cmake_minimum_required(VERSION 3.20.0)
set(BOARD adafruit_feather_nrf52840) # added
find_package(Zephyr REQUIRED HINTS $ENV{ZEPHYR_BASE})

project(final_patch)

target_sources(app PRIVATE 
    src/main.c
    src/inputs.c 
    src/outputs.c
    src/ble.c
    src/rtc.c
)
```

## prj.conf
```kconfig
# Peripherals 
CONFIG_NRFX_PWM0=y
CONFIG_NRFX_PWM1=y
CONFIG_NRFX_PWM2=y
CONFIG_GPIO=n
CONFIG_NRFX_GPIOTE0=y
CONFIG_NRFX_PPI=y
CONFIG_NRFX_TIMER1=y
CONFIG_NRFX_TIMER2=y
CONFIG_NRFX_TIMER3=y
CONFIG_NRFX_TIMER4=y
CONFIG_NRFX_EGU0=y
CONFIG_NRFX_RTC2=y

CONFIG_ZERO_LATENCY_IRQS=y

#CONFIG_ASSERT=y 

# Logger module
CONFIG_BT_L2CAP_TX_MTU=64
CONFIG_BT_BUF_ACL_RX_SIZE=64
CONFIG_BT_LOG_LEVEL_INF=y

# Bluetooth LE
CONFIG_BT=y
CONFIG_BT_PERIPHERAL=y
CONFIG_BT_DEVICE_NAME="SPECT_PATCH1"

# RTT 
CONFIG_LOG=y
CONFIG_USE_SEGGER_RTT=y
CONFIG_LOG_BACKEND_UART=n
CONFIG_LOG_BACKEND_RTT=y
```

## src/main.c
```c
#include "final_patch.h" 
#include "inputs.h"
#include "outputs.h"
#include "rtc.h" 

LOG_MODULE_REGISTER(final_patch, LOG_LEVEL_INF);

// hardware instances 
const nrfx_timer_t timer_sramout_inst = NRFX_TIMER_INSTANCE(TIMER_SRAMOUT_INST_IDX); 
const nrfx_timer_t timer_dataout_inst = NRFX_TIMER_INSTANCE(TIMER_DATAOUT_INST_IDX);
const nrfx_pwm_t pwm_sipo_instance = NRFX_PWM_INSTANCE(PWM_SIPO_INST_IDX);
const nrfx_pwm_t pwm_clk_base_instance = NRFX_PWM_INSTANCE(PWM_CLK_BASE_INST_IDX);
const nrfx_pwm_t pwm_clk_1mhz_instance = NRFX_PWM_INSTANCE(PWM_CLK_1MHZ_INST_IDX); 

// global variables 
volatile uint32_t sramout_buffer[4]; 
volatile uint32_t dataout_buffer = 0; 
volatile int sramout_count = 0;
volatile int dataout_count = 0; 
 
nrf_pwm_values_grouped_t sipo_buffer[SIPO_DATA_LEN]; 
nrf_pwm_values_common_t clk_base_value = 3200;
nrf_pwm_values_common_t clk_1mhz_value = 8 | 0x8000;
volatile uint32_t rtc_overflow_count = 0;
volatile bool sipo_done = false; 
volatile bool dac_i2c_done = false;

volatile uint32_t ble_al_counter = 0;
volatile uint32_t ble_dl_counter = 0;
volatile uint8_t done_wr_sipo = 0;
volatile uint8_t done_wr_dac = 0;

volatile uint8_t done_rd_SRAM = 0; 

struct k_work sramout_work;
struct k_work dataout_work;

// pwm sequences 
nrf_pwm_sequence_t seq_sipo =
{
    .values.p_grouped = sipo_buffer,
    .length           = SIPO_DATA_LEN * 2, 
    .repeats          = 0,
    .end_delay        = 0
}; 

nrf_pwm_sequence_t seq_clk_base =
{
    .values.p_common = &clk_base_value,
    .length           = 1, 
    .repeats          = 0,
    .end_delay        = 0
};

nrf_pwm_sequence_t seq_clk_1mhz =
{
    .values.p_common = &clk_1mhz_value,
    .length           = 1, 
    .repeats          = 0,
    .end_delay        = 0
}; 

void sramout_work_handler(struct k_work *work)
{
    // All the bit-shifting and BLE notification logic we wrote earlier
    int count = sramout_count;
    
    process_sramout(sramout_buffer, count); 
}

void dataout_work_handler(struct k_work *work)
{   
    uint64_t ts = get_current_timestamp(); 
    uint32_t val = dataout_buffer;
    int count = dataout_count;

    process_dataout(val, count, ts);  
}


void initialize_patch(void) {

        // pin initalizations 
        nrf_gpio_pin_clear(CH_RST);
        nrf_gpio_cfg_output(CH_RST);

        nrf_gpio_cfg_input(SRAMOUT_DATA_IN, NRF_GPIO_PIN_NOPULL); 
        nrf_gpio_cfg_input(SRAMOUT_CLK_IN, NRF_GPIO_PIN_NOPULL);

        nrf_gpio_cfg_input(DATAOUT_DATA_IN, NRF_GPIO_PIN_NOPULL); 
        nrf_gpio_cfg_input(DATAOUT_CLK_IN, NRF_GPIO_PIN_NOPULL);

        // inputs 
        gpiote_inputs_init(); 
        timer_timeout_init(); 
        timer_counter_init();
        ppi_inputs_init(); 

        // outputs 
        pwm_clk_base_init();
        pwm_clk_1mhz_init(); 
        pwm_sipo_init(); 
        ppi_outputs_init(); 
        dac_init(); 

        // trigger global clocks 
        clk_base_trigger_transfer();
        k_usleep(100);
        clk_1mhz_trigger_transfer(); 

        // initialize workers 
        k_work_init(&sramout_work, sramout_work_handler);
        k_work_init(&dataout_work, dataout_work_handler);

        // initialize bluetooth 
        int err;

        // erase for actual patch 
        nrf_gpio_cfg_output(BLE_LED);
        nrf_gpio_pin_clear(BLE_LED); 
        reset_dl_counter(); 
        reset_al_counter(); 

        err = bt_enable(NULL); 
        if (err) {
            LOG_ERR("Bluetooth init failed \n"); 
            return; 
        } 
        LOG_INF("BT success");

        // start advertising 
        // err = bt_le_adv_start(BT_LE_ADV_CONN, NULL, 0, NULL, 0); 
        patch_ad_start();  
        LOG_INF("Advertising successfully started");

}


int main(void)
{
        LOG_INF("Start Patch \n"); 
        
        // initialize patch 
        initialize_patch(); 

        // patch is idle 
        while (1) {
                k_sleep(K_MSEC(1000));
                // test erase 
                
        }
}
```

## src/ble.c
```c
/**
 * @file ble.c
 * @author Archie Lee
 * @brief Handles patch BLE logic. 
 * @details Implements BLE connection, advertisement, communication, and GATT server.  
 * @version 1.0
 * @date 2026-01-23
 */

/* Includes ------------------------------------------------------------------*/
#include "final_patch.h" 
#include "inputs.h"
#include "outputs.h" 

// logging 
LOG_MODULE_REGISTER(spect, LOG_LEVEL_INF);
#define NRFX_LOG_MODULE                 EXAMPLE
#define NRFX_EXAMPLE_CONFIG_LOG_ENABLED 1
#define NRFX_EXAMPLE_CONFIG_LOG_LEVEL   3

/* UUID ------------------------------------------------------------------*/
#define SPECT_BASE_UUID BT_UUID_128_ENCODE(0x7231db4c, 0x67ed, 0x4bf7, 0xbe9f, 0x2b84348147ee)

static struct bt_uuid_128 spect_uuid = BT_UUID_INIT_128(SPECT_BASE_UUID);
static struct bt_uuid_128 sipo_uuid  = BT_UUID_INIT_128(BT_UUID_128_ENCODE(0x7231db4d, 0x67ed, 0x4bf7, 0xbe9f, 0x2b84348147ee)); 
static struct bt_uuid_128 dac_uuid  = BT_UUID_INIT_128(BT_UUID_128_ENCODE(0x7231db4e, 0x67ed, 0x4bf7, 0xbe9f, 0x2b84348147ee));
static struct bt_uuid_128 sramout_uuid  = BT_UUID_INIT_128(BT_UUID_128_ENCODE(0x7231db4f, 0x67ed, 0x4bf7, 0xbe9f, 0x2b84348147ee));
static struct bt_uuid_128 al_uuid  = BT_UUID_INIT_128(BT_UUID_128_ENCODE(0x7231db50, 0x67ed, 0x4bf7, 0xbe9f, 0x2b84348147ee));
static struct bt_uuid_128 dl_uuid  = BT_UUID_INIT_128(BT_UUID_128_ENCODE(0x7231db51, 0x67ed, 0x4bf7, 0xbe9f, 0x2b84348147ee)); 
static struct bt_uuid_128 dataout_uuid  = BT_UUID_INIT_128(BT_UUID_128_ENCODE(0x7231db52, 0x67ed, 0x4bf7, 0xbe9f, 0x2b84348147ee));
static struct bt_uuid_128 syscmd_uuid  = BT_UUID_INIT_128(BT_UUID_128_ENCODE(0x7231db53, 0x67ed, 0x4bf7, 0xbe9f, 0x2b84348147ee));

const struct bt_data ad[] = {
    /* Set advertising flags: General discoverable, BR/EDR not supported */
    BT_DATA_BYTES(BT_DATA_FLAGS, (BT_LE_AD_GENERAL | BT_LE_AD_NO_BREDR)),
    
    /* Advertise the 128-bit Service UUID so the Motherboard can filter for it */
    BT_DATA_BYTES(BT_DATA_UUID128_ALL, 
        0xee, 0x47, 0x81, 0x34, 0x84, 0x2b, 0x9f, 0xbe, 
        0xf7, 0x4b, 0xed, 0x67, 0x4c, 0xdb, 0x31, 0x72),
    
};

/* Global Variables ------------------------------------------------------------------*/
struct bt_conn *current_conn;
struct sramout_ble_packet ble_sramout_packet;

/* BLE Connection Functions ------------------------------------------------------------------*/
void on_connected(struct bt_conn *conn, uint8_t err)
{
    if (err) {
        LOG_ERR("Connection failed (err %u)\n", err);
        return;
    }

    LOG_INF("Connected! Motherboard is now talking to us.\n");

    // erase for actual patch 
    nrf_gpio_pin_set(BLE_LED);
    
    // Save the connection reference
    current_conn = bt_conn_ref(conn);
} 

void on_disconnected(struct bt_conn *conn, uint8_t reason)
{
    printk("Disconnected (reason %u)\n", reason);
    // erase for actual patch 
    nrf_gpio_pin_clear(BLE_LED); 
    
    if (current_conn) {
        bt_conn_unref(current_conn);
        current_conn = NULL;
    }
    
    // CRITICAL: Start advertising again so the Motherboard can reconnect!
    // bt_le_adv_start(BT_LE_ADV_CONN, NULL, 0, NULL, 0);
    patch_ad_start();
}

// Register the callbacks with the system
BT_CONN_CB_DEFINE(conn_callbacks) = {
    .connected = on_connected,
    .disconnected = on_disconnected,
};

/* BLE Callback Functions ------------------------------------------------------------------*/
static ssize_t sipo_write_cb(struct bt_conn *conn, const struct bt_gatt_attr *attr,
                             const void *buf, uint16_t len, uint16_t offset, uint8_t flags)
{
    if (len != 16) {
        return BT_GATT_ERR(BT_ATT_ERR_INVALID_ATTRIBUTE_LEN);
    }

    
    sipo_reset(); 
    reset_sramout();  

    const uint8_t *data = (const uint8_t *)buf; 

    // LOG_INF("First byte: 0x%02X \n", data[0]);
    // LOG_INF("Second byte: 0x%02X \n", data[1]);
    // LOG_INF("Second byte: 0x%02X \n", data[2]);
    // LOG_INF("Sixth byte: 0x%02X \n", data[6]);
    // LOG_INF("Twelvth byte: 0x%02X \n", data[12]);
    // LOG_INF("Last byte: 0x%02X \n", data[15]);

    // prepare sipo_buffer 
    prepare_sipo_buffer(data); 

    // send the sipo data 
    sipo_trigger_transfer(); 

    // start the sipo transfer for now lets assume sending the sipo data means sipo_trigger 
    LOG_INF("SIPO Data Received! Sending the SIPO data with first byte: 0x%02X and last byte: 0x%02X", data[0], data[len-1]); 

    while(!sipo_done) {
        k_usleep(10); 
    }

    // sipo is done 
    done_wr_sipo = 1; 

    // notify motherboard that sipo is done 
    bt_gatt_notify(conn, attr, (const void *)&done_wr_sipo, sizeof(done_wr_sipo)); 

    LOG_INF("SIPO done! Sent done_wr_sipo to motherboard \n");

    return len;
} 

// dac write callback 
static ssize_t dac_write_cb(struct bt_conn *conn, const struct bt_gatt_attr *attr,
                             const void *buf, uint16_t len, uint16_t offset, uint8_t flags)
{
    if (len != 5) {
        return BT_GATT_ERR(BT_ATT_ERR_INVALID_ATTRIBUTE_LEN);
    }

    // Copy incoming wireless data to our local buffer
    //memcpy(ble_dac_buffer, buf, len);

    const uint8_t *data = (const uint8_t *)buf;

    // send dac data 
    dac_reset(); 
    dac_i2c_write(data, len); 

    // start the dac transfer for now lets assume sending the dac data means dac_trigger 
    LOG_INF("DAC Data Received! Sending the DAC data with first byte: 0x%02X and last byte: 0x%02X", data[0], data[len-1]); 

    // dac is done 
    done_wr_dac = 1; 
                    
    // notify motherboard that sipo is done 
    bt_gatt_notify(conn, attr, &done_wr_dac, sizeof(done_wr_dac));

    LOG_INF("DAC done! Sent done_wr_dac to motherboard \n");

    return len;
} 

// sramout read callback 
static ssize_t sramout_read_cb(struct bt_conn *conn, const struct bt_gatt_attr *attr,
                            void *buf, uint16_t len, uint16_t offset)
{

    // This helper function handles the offset and length logic for you 
    return bt_gatt_attr_read(conn, attr, buf, len, offset, &ble_sramout_packet, sizeof(ble_sramout_packet));
    
} 

// al read callback 
static ssize_t al_read_cb(struct bt_conn *conn, const struct bt_gatt_attr *attr,
                            void *buf, uint16_t len, uint16_t offset)
{

    update_al_counter(); 
    
    // This helper function handles the offset and length logic for you 
    return bt_gatt_attr_read(conn, attr, buf, len, offset, &ble_al_counter, sizeof(ble_al_counter));
} 

// dl read callback 
static ssize_t dl_read_cb(struct bt_conn *conn, const struct bt_gatt_attr *attr,
                            void *buf, uint16_t len, uint16_t offset)
{

    update_dl_counter();
 
    // This helper function handles the offset and length logic for you 
    return bt_gatt_attr_read(conn, attr, buf, len, offset, &ble_dl_counter, sizeof(ble_dl_counter));
}

// dataout read callback 
static ssize_t dataout_read_cb(struct bt_conn *conn, const struct bt_gatt_attr *attr,
                            void *buf, uint16_t len, uint16_t offset)
{
    
    // uint32_t val;

    // // Attempt to pop ONE word from the FIFO
    // if (k_msgq_get(&fifo_data_out, &val, K_NO_WAIT) == 0) {
    //     // Prepare the 4-byte buffer
    //     uint8_t temp_buf[4];
    //     temp_buf[0] = (val >> 24) & 0xFF;
    //     temp_buf[1] = (val >> 16) & 0xFF;
    //     temp_buf[2] = (val >> 8) & 0xFF;
    //     temp_buf[3] = val & 0xFF;

    //     LOG_INF("Dataout read request: Popping 0x%08X", val);
    //     return bt_gatt_attr_read(conn, attr, buf, len, offset, temp_buf, sizeof(temp_buf));
    // } else {
    //     // FIFO is empty, return 0 or an error code
    //     LOG_WRN("Dataout read request: FIFO Empty");
    //     return 0; 
    // }

    struct dataout_ble_packet pkt; 
    if (k_msgq_get(&fifo_data_out, &pkt, K_NO_WAIT) == 0){
        LOG_INF("Dataout read request: Popping 0x%08X", pkt.dataout);
        return bt_gatt_attr_read(conn, attr, buf, len, offset, &pkt, sizeof(pkt));
    } else {
        // FIFO is empty, return 0 or an error code
        LOG_WRN("Dataout read request: FIFO Empty");
        return 0; 
    }
}

// sys command callback 
static ssize_t syscmd_write_cb(struct bt_conn *conn, const struct bt_gatt_attr *attr,
                             const void *buf, uint16_t len, uint16_t offset, uint8_t flags) 
{
    uint8_t command = ((uint8_t *)buf)[0];
    
    switch (command) {
        case 0x01: // reset sipo
            done_wr_sipo = 0; 
            //memset((void*)sipo_buffer, 0, sizeof(sipo_buffer));
            LOG_INF("reset sipo \n");
            break;
        
        case 0x02: // reset dac
            dac_reset(); 
            //memset((void*)dac_buffer, 0, sizeof(dac_buffer));
            LOG_INF("reset dac \n"); 
            break; 
        
        case 0x03: // reset sramout   
            reset_sramout(); 
            LOG_INF("reset sramout \n"); 
            break; 
        
        case 0x04: // reset aldl
            reset_al_counter(); 
            reset_dl_counter();  
            LOG_INF("reset aldl \n");  
            break; 
        
        case 0x05: // reset dataout + start rtc timer
            reset_dataout(); 
            LOG_INF("reset dataout \n"); 
            break;
        
        case 0x06: // reset chip 
            LOG_INF("reset chip \n"); 
            chip_reset(); 
            break;
        
        case 0x07: // reset global
            LOG_INF("reset global \n"); 
            break;

        default:
            LOG_INF("Unknown Command: 0x%02X\n", command);
            return BT_GATT_ERR(BT_ATT_ERR_VALUE_NOT_ALLOWED);
    }

    return len; 

}

void patch_ad_start(void) {
    int err = bt_le_adv_start(BT_LE_ADV_CONN, ad, ARRAY_SIZE(ad), NULL, 0);
    if (err) {
        LOG_ERR("Adv start failed (err %d)", err);
    }
}

/* GATT Server ------------------------------------------------------------------*/
BT_GATT_SERVICE_DEFINE(spect_svc,
        BT_GATT_PRIMARY_SERVICE(&spect_uuid),
        BT_GATT_CHARACTERISTIC(&sipo_uuid.uuid,
                    BT_GATT_CHRC_WRITE | BT_GATT_CHRC_NOTIFY,    // Motherboard can write
                    BT_GATT_PERM_WRITE,    // Requires write permission
                    NULL, sipo_write_cb, NULL), 
        BT_GATT_CCC(NULL, BT_GATT_PERM_READ | BT_GATT_PERM_WRITE), 
        BT_GATT_CHARACTERISTIC(&dac_uuid.uuid,
                    BT_GATT_CHRC_WRITE | BT_GATT_CHRC_NOTIFY,    // Motherboard can write
                    BT_GATT_PERM_WRITE,    // Requires write permission
                    NULL, dac_write_cb, NULL), 
        BT_GATT_CCC(NULL, BT_GATT_PERM_READ | BT_GATT_PERM_WRITE), 
        BT_GATT_CHARACTERISTIC(&sramout_uuid.uuid,
                    BT_GATT_CHRC_READ | BT_GATT_CHRC_NOTIFY,    // Motherboard can read
                    BT_GATT_PERM_READ,    // Requires read permission
                    sramout_read_cb, NULL, NULL),
        BT_GATT_CCC(NULL, BT_GATT_PERM_READ | BT_GATT_PERM_WRITE), 
        BT_GATT_CHARACTERISTIC(&al_uuid.uuid,
                    BT_GATT_CHRC_READ,    // Motherboard can read
                    BT_GATT_PERM_READ,    // Requires read permission
                    al_read_cb, NULL, NULL),
        BT_GATT_CHARACTERISTIC(&dl_uuid.uuid,
                    BT_GATT_CHRC_READ,    // Motherboard can read
                    BT_GATT_PERM_READ,    // Requires read permission
                    dl_read_cb, NULL, NULL),
        BT_GATT_CHARACTERISTIC(&dataout_uuid.uuid,
                    BT_GATT_CHRC_READ | BT_GATT_CHRC_NOTIFY,    // Motherboard can read
                    BT_GATT_PERM_READ,    // Requires read permission
                    dataout_read_cb, NULL, NULL),
        BT_GATT_CCC(NULL, BT_GATT_PERM_READ | BT_GATT_PERM_WRITE),
        BT_GATT_CHARACTERISTIC(&syscmd_uuid.uuid,
                    BT_GATT_CHRC_WRITE,    
                    BT_GATT_PERM_WRITE,    
                    NULL, syscmd_write_cb, NULL)
);
```

## src/ble.h
```c
/**
 * @file ble.h
 * @author Archie Lee
 * @brief Header file for BLE patch logic.
 * @details Defines the public structures and function prototypes for 
 * BLE connection, advertisement, communication, and GATT server.
 * @version 1.0
 * @date 2026-01-23
 */

#ifndef BLE_H
#define BLE_H

#ifdef __cplusplus
extern "C" {
#endif

/* --- UUID --- */
#define SPECT_BASE_UUID BT_UUID_128_ENCODE(0x7231db4c, 0x67ed, 0x4bf7, 0xbe9f, 0x2b84348147ee)

extern struct bt_uuid_128 spect_uuid;
extern struct bt_uuid_128 sipo_uuid;  
extern struct bt_uuid_128 dac_uuid;
extern struct bt_uuid_128 sramout_uuid;
extern struct bt_uuid_128 al_uuid;
extern struct bt_uuid_128 dl_uuid;
extern struct bt_uuid_128 dataout_uuid;
extern struct bt_uuid_128 syscmd_uuid;

/* --- Function Prototypes --- */
/**
 * @brief Begins advertisement.
 */
void patch_ad_start(void);
 
#ifdef __cplusplus
}
#endif

#endif /* BLE_H */
```

## src/final_patch.h
```c
/**
 * @file final_patch.h
 * @author Archie Lee
 * @brief Header file for patch.
 * @details Defines includes, pin configurations, peripheral instances,  
 * peripheral channels, and global variables.
 * @version 1.0
 * @date 2026-01-23
 */

#ifndef FINAL_PATCH_H
#define FINAL_PATCH_H

/* Includes ------------------------------------------------------------------*/
#include <zephyr/kernel.h>
#include <zephyr/logging/log.h>
#include <zephyr/bluetooth/bluetooth.h>
#include <zephyr/bluetooth/gatt.h>
#include <zephyr/bluetooth/uuid.h>

#include <nrfx_pwm.h>
#include <nrfx_timer.h>

#include <hal/nrf_pwm.h>
#include <hal/nrf_ppi.h>
#include <hal/nrf_timer.h>
#include <hal/nrf_gpiote.h>
#include <hal/nrf_gpio.h>
#include <hal/nrf_egu.h>
#include <hal/nrf_rtc.h>

#include <zephyr/irq.h>

#include <inttypes.h>

#ifdef __cplusplus
extern "C" {
#endif

// pin configurations 
#define SRAMOUT_CLK_IN 27 //27 
#define SRAMOUT_DATA_IN 26 //26
#define DATAOUT_CLK_IN 4 //4
#define DATAOUT_DATA_IN 5 //5
#define AL_DATA_IN 24
#define DL_DATA_IN 15

#define DAC_SDA_PIN 12
#define DAC_SCL_PIN 11
#define SIPO_CLK_OUT 8
#define SIPO_DATA_OUT 6
#define CLK_1MHZ_OUT 14 
#define CLK_BASE_OUT 13
#define CH_RST NRF_GPIO_PIN_MAP(1, 8)

#define BLE_LED NRF_GPIO_PIN_MAP(1, 10)

// hardware instance indicies 
#define GPIOTE_INST_IDX 0

#define TIMER_SRAMOUT_INST_IDX 4
#define TIMER_DATAOUT_INST_IDX 1
#define TIMER_AL_INST NRF_TIMER2 
#define TIMER_DL_INST NRF_TIMER3

#define PWM_CLK_BASE_INST_IDX 0
#define PWM_SIPO_INST_IDX 1
#define PWM_CLK_1MHZ_INST_IDX 2

// gpiote channels 
#define GPIOTE_BASE_CLK_CH 0 
#define GPIOTE_SRAMOUT_CH 1
#define GPIOTE_DATAOUT_CH 2
#define GPIOTE_AL_CH 3
#define GPIOTE_DL_CH 4 

// ppi channels 
#define PPI_SRAMOUT_CH NRF_PPI_CHANNEL0 
#define PPI_DATAOUT_CH NRF_PPI_CHANNEL1
#define PPI_EGU_CH NRF_PPI_CHANNEL2
#define PPI_SIPO_CH NRF_PPI_CHANNEL3
#define PPI_CLK_1MHZ_CH NRF_PPI_CHANNEL4 
#define PPI_AL_CH NRF_PPI_CHANNEL5 
#define PPI_DL_CH NRF_PPI_CHANNEL6

// pin mask 
#define SRAMOUT_PIN_MASK (1 << SRAMOUT_DATA_IN)
#define DATAOUT_PIN_MASK (1 << DATAOUT_DATA_IN)

// data length 
#define SIPO_DATA_LEN 126

// hardware instances
extern const nrfx_timer_t timer_sramout_inst; 
extern const nrfx_timer_t timer_dataout_inst;
extern const nrfx_pwm_t pwm_sipo_instance;
extern const nrfx_pwm_t pwm_clk_base_instance;
extern const nrfx_pwm_t pwm_clk_1mhz_instance;

// global variables 
extern volatile uint32_t sramout_buffer[4]; 
extern volatile uint32_t dataout_buffer; 
extern volatile int sramout_count;
extern volatile int dataout_count; 
extern nrf_pwm_values_grouped_t sipo_buffer[SIPO_DATA_LEN]; 
extern nrf_pwm_values_common_t clk_base_value;
extern nrf_pwm_values_common_t clk_1mhz_value;
extern volatile uint32_t rtc_overflow_count; 

// dataout fifo buffer 
extern struct k_msgq fifo_data_out;

// done signals 
extern volatile bool sipo_done; 
extern volatile bool dac_i2c_done;

extern volatile uint32_t ble_al_counter;
extern volatile uint32_t ble_dl_counter;
extern volatile uint8_t done_wr_sipo;
extern volatile uint8_t done_wr_dac; 

extern volatile uint8_t done_rd_SRAM; 

// ble data 
struct __packed sramout_ble_packet {
    uint16_t SRAM_out0;
    uint16_t SRAM_out1;
    uint16_t SRAM_out2;
    uint16_t SRAM_out3;
    uint16_t SRAM_out4;
    uint16_t SRAM_out5;
    uint16_t SRAM_out6;
}; 

extern struct sramout_ble_packet ble_sramout_packet;

struct __packed dataout_ble_packet {
    uint32_t dataout; 
    uint64_t timestamp; 
}; 

extern struct bt_conn *current_conn;

extern const struct bt_gatt_service_static spect_svc;

extern const struct bt_data ad[2]; 

// pwm sequences 
extern nrf_pwm_sequence_t seq_sipo;   
extern nrf_pwm_sequence_t seq_clk_base;
extern nrf_pwm_sequence_t seq_clk_1mhz; 

// workers 
extern struct k_work sramout_work;
extern struct k_work dataout_work;

#ifdef __cplusplus
}
#endif

#endif /* FINAL_PATCH_H */
```

## src/inputs.c
```c
/**
 * @file inputs.c
 * @author Archie Lee
 * @brief Handles data interface between nrf52840 inputs and ASIC. 
 * @details Implements SRAMOUT, DATAOUT, AL, and DL inputs.  
 * @version 1.0
 * @date 2026-01-23
 */

/* Includes ------------------------------------------------------------------*/
#include "final_patch.h"

LOG_MODULE_DECLARE(final_patch, LOG_LEVEL_INF);

// dataout fifo 
//K_MSGQ_DEFINE(fifo_data_out, sizeof(uint32_t), 32, 4);
K_MSGQ_DEFINE(fifo_data_out, sizeof(struct dataout_ble_packet), 32, 4);

/* ISR ------------------------------------------------------------------*/
// https://docs.zephyrproject.org/latest/kernel/services/interrupts.html 
__attribute__((section(".ramfunc")))
ISR_DIRECT_DECLARE(gpiote_fast_handler)
{
    NRF_GPIOTE->EVENTS_IN[1] = 0;

    uint32_t count = sramout_count;

    if (NRF_P0->IN & (1 << SRAMOUT_DATA_IN)) {
        // Shifting a constant 1UL is faster than variable math
        sramout_buffer[count >> 5] |= (1UL << (count & 31));
    }
        sramout_count = count + 1; 

    return 0;
}

__attribute__((section(".ramfunc")))
ISR_DIRECT_DECLARE(egu_fast_handler) {
    NRF_GPIOTE->EVENTS_IN[2] = 0;
    NRF_EGU0->EVENTS_TRIGGERED[0] = 0;

    if (NRF_P0->IN & (1 << DATAOUT_DATA_IN)) {
        dataout_buffer |= (1 << dataout_count);
    }
    dataout_count++;
    return 0;
}


/* Timeout Handlers ------------------------------------------------------------------*/
static void timer_sramout_handler(nrf_timer_event_t event_type, void * p_context) {
        if (event_type == NRF_TIMER_EVENT_COMPARE0) {
        // packet is finished 
                if (sramout_count > 0) {
                        k_work_submit(&sramout_work); 
                }
        }
}

static void timer_dataout_handler(nrf_timer_event_t event_type, void * p_context) {
        if (event_type == NRF_TIMER_EVENT_COMPARE0) {
        // packet is finished 
                if (dataout_count > 0) {
                        k_work_submit(&dataout_work); 
                }
        }
} 


/* Peipheral Initializations ------------------------------------------------------------------*/
void gpiote_inputs_init(void) {

        // enable instruction cache
        NRF_NVMC->ICACHECNF = NVMC_ICACHECNF_CACHEEN_Enabled << NVMC_ICACHECNF_CACHEEN_Pos;

        IRQ_DIRECT_CONNECT(GPIOTE_IRQn, 0, gpiote_fast_handler, IRQ_ZERO_LATENCY);
        irq_enable(GPIOTE_IRQn);

        IRQ_DIRECT_CONNECT(SWI0_EGU0_IRQn, 0, egu_fast_handler, IRQ_ZERO_LATENCY);
        irq_enable(SWI0_EGU0_IRQn);

        // sramout channel 
        NRF_GPIOTE->CONFIG[1] = (GPIOTE_CONFIG_MODE_Event      << GPIOTE_CONFIG_MODE_Pos)   |
                            (SRAMOUT_CLK_IN                        << GPIOTE_CONFIG_PSEL_Pos)   |
                            (GPIOTE_CONFIG_POLARITY_LoToHi << GPIOTE_CONFIG_POLARITY_Pos);

        NRF_GPIOTE->INTENSET = GPIOTE_INTENSET_IN1_Msk;

        nrf_gpio_cfg_input(SRAMOUT_DATA_IN, NRF_GPIO_PIN_NOPULL);

        // egu for dataout 
        NRF_EGU0->EVENTS_TRIGGERED[0] = 0;
        NRF_EGU0->INTENSET = EGU_INTENSET_TRIGGERED0_Msk;

        // dataout channel 
        NRF_GPIOTE->CONFIG[2] = (GPIOTE_CONFIG_MODE_Event      << GPIOTE_CONFIG_MODE_Pos)   |
                            (DATAOUT_CLK_IN                        << GPIOTE_CONFIG_PSEL_Pos)   |
                            (GPIOTE_CONFIG_POLARITY_LoToHi << GPIOTE_CONFIG_POLARITY_Pos);
        
        NRF_GPIOTE->INTENCLR = GPIOTE_INTENCLR_IN2_Msk;

        nrf_gpio_cfg_input(DATAOUT_DATA_IN, NRF_GPIO_PIN_NOPULL);

        // connect dataout with egu 
        nrf_ppi_channel_endpoint_setup(NRF_PPI, PPI_EGU_CH, 
                (uint32_t)&NRF_GPIOTE->EVENTS_IN[2], 
                (uint32_t)&NRF_EGU0->TASKS_TRIGGER[0]
        ); 

        nrf_ppi_channel_enable(NRF_PPI, PPI_EGU_CH);

        // counter gpiote enable 
        nrf_gpiote_event_configure(NRF_GPIOTE, GPIOTE_AL_CH, AL_DATA_IN, NRF_GPIOTE_POLARITY_LOTOHI);
        nrf_gpiote_event_enable(NRF_GPIOTE, GPIOTE_AL_CH);

        nrf_gpiote_event_configure(NRF_GPIOTE, GPIOTE_DL_CH, DL_DATA_IN, NRF_GPIOTE_POLARITY_LOTOHI);
        nrf_gpiote_event_enable(NRF_GPIOTE, GPIOTE_DL_CH);

} 

void timer_timeout_init(void) {
        IRQ_CONNECT(NRFX_IRQ_NUMBER_GET(NRF_TIMER_INST_GET(TIMER_SRAMOUT_INST_IDX)), IRQ_PRIO_LOWEST,
                NRFX_TIMER_INST_HANDLER_GET(TIMER_SRAMOUT_INST_IDX), 0, 0);
        
        IRQ_CONNECT(NRFX_IRQ_NUMBER_GET(NRF_TIMER_INST_GET(TIMER_DATAOUT_INST_IDX)), IRQ_PRIO_LOWEST,
                NRFX_TIMER_INST_HANDLER_GET(TIMER_DATAOUT_INST_IDX), 0, 0);

        // sramout timeout 
        uint32_t base_frequency = NRF_TIMER_BASE_FREQUENCY_GET(timer_sramout_inst.p_reg);
        nrfx_timer_config_t sramout_config = NRFX_TIMER_DEFAULT_CONFIG(base_frequency);
        sramout_config.bit_width = NRF_TIMER_BIT_WIDTH_32;
        
        nrfx_err_t err = nrfx_timer_init(&timer_sramout_inst, &sramout_config, timer_sramout_handler); 
        if (err != NRFX_SUCCESS) {
                LOG_INF("sramout timer init failed");
        }
        LOG_INF("sramout timer init succeeded");
        
        nrfx_timer_clear(&timer_sramout_inst);

        uint32_t desired_ticks = nrfx_timer_us_to_ticks(&timer_sramout_inst, 20); // 1s
        nrfx_timer_extended_compare(&timer_sramout_inst, NRF_TIMER_CC_CHANNEL0, desired_ticks,
                                NRF_TIMER_SHORT_COMPARE0_STOP_MASK, true);

        // turn timer off initially 
        nrf_timer_task_trigger(timer_sramout_inst.p_reg, NRF_TIMER_TASK_STOP);
        nrf_timer_task_trigger(timer_sramout_inst.p_reg, NRF_TIMER_TASK_CLEAR);

        // dataout timeout 
        base_frequency = NRF_TIMER_BASE_FREQUENCY_GET(timer_dataout_inst.p_reg);
        nrfx_timer_config_t dataout_config = NRFX_TIMER_DEFAULT_CONFIG(base_frequency);
        dataout_config.bit_width = NRF_TIMER_BIT_WIDTH_32;
        
        err = nrfx_timer_init(&timer_dataout_inst, &dataout_config, timer_dataout_handler); 
        if (err != NRFX_SUCCESS) {
                LOG_INF("dataout timer init failed");
        }
        LOG_INF("dataout timer init succeeded");
        
        nrfx_timer_clear(&timer_dataout_inst);

        desired_ticks = nrfx_timer_us_to_ticks(&timer_dataout_inst, 20); // 1s
        nrfx_timer_extended_compare(&timer_dataout_inst, NRF_TIMER_CC_CHANNEL0, desired_ticks,
                                NRF_TIMER_SHORT_COMPARE0_STOP_MASK, true);

        // turn timer off initially 
        nrf_timer_task_trigger(timer_dataout_inst.p_reg, NRF_TIMER_TASK_STOP);
        nrf_timer_task_trigger(timer_dataout_inst.p_reg, NRF_TIMER_TASK_CLEAR);
} 

void timer_counter_init(void) {
        // AL counter 
        nrf_timer_task_trigger(TIMER_AL_INST, NRF_TIMER_TASK_STOP);
        nrf_timer_task_trigger(TIMER_AL_INST, NRF_TIMER_TASK_CLEAR);

        nrf_timer_mode_set(TIMER_AL_INST, NRF_TIMER_MODE_COUNTER); 
        nrf_timer_bit_width_set(TIMER_AL_INST, NRF_TIMER_BIT_WIDTH_32);

        nrf_timer_task_trigger(TIMER_AL_INST, NRF_TIMER_TASK_START);

        // DL counter 
        nrf_timer_task_trigger(TIMER_DL_INST, NRF_TIMER_TASK_STOP);
        nrf_timer_task_trigger(TIMER_DL_INST, NRF_TIMER_TASK_CLEAR);

        nrf_timer_mode_set(TIMER_DL_INST, NRF_TIMER_MODE_COUNTER); 
        nrf_timer_bit_width_set(TIMER_DL_INST, NRF_TIMER_BIT_WIDTH_32);

        nrf_timer_task_trigger(TIMER_DL_INST, NRF_TIMER_TASK_START);
}

void ppi_inputs_init(void) {
        // low to high --> start timer 
        nrf_ppi_channel_endpoint_setup(NRF_PPI, PPI_SRAMOUT_CH, 
                (uint32_t)&NRF_GPIOTE->EVENTS_IN[1], 
                nrfx_timer_task_address_get(&timer_sramout_inst, NRF_TIMER_TASK_CLEAR)
        ); 

        // low to high --> clear timer 
        nrf_ppi_fork_endpoint_setup(NRF_PPI, PPI_SRAMOUT_CH, nrfx_timer_task_address_get(&timer_sramout_inst, NRF_TIMER_TASK_START)); 

        nrf_ppi_channel_enable(NRF_PPI, PPI_SRAMOUT_CH); 

        // low to high --> start timer 
        nrf_ppi_channel_endpoint_setup(NRF_PPI, PPI_DATAOUT_CH, 
                (uint32_t)&NRF_GPIOTE->EVENTS_IN[2], 
                nrfx_timer_task_address_get(&timer_dataout_inst, NRF_TIMER_TASK_CLEAR)
        ); 

        // low to high --> clear timer 
        nrf_ppi_fork_endpoint_setup(NRF_PPI, PPI_DATAOUT_CH, nrfx_timer_task_address_get(&timer_dataout_inst, NRF_TIMER_TASK_START)); 

        nrf_ppi_channel_enable(NRF_PPI, PPI_DATAOUT_CH);

        // counters 
        nrf_ppi_channel_endpoint_setup(NRF_PPI, PPI_AL_CH, 
                nrf_gpiote_event_address_get(NRF_GPIOTE, nrf_gpiote_in_event_get(GPIOTE_AL_CH)), 
                nrf_timer_task_address_get(TIMER_AL_INST, NRF_TIMER_TASK_COUNT)
        );

        nrf_ppi_channel_enable(NRF_PPI, PPI_AL_CH);

        nrf_ppi_channel_endpoint_setup(NRF_PPI, PPI_DL_CH, 
                nrf_gpiote_event_address_get(NRF_GPIOTE, nrf_gpiote_in_event_get(GPIOTE_DL_CH)), 
                nrf_timer_task_address_get(TIMER_DL_INST, NRF_TIMER_TASK_COUNT)
        );

        nrf_ppi_channel_enable(NRF_PPI, PPI_DL_CH);
}


/* Reset Functions ------------------------------------------------------------------*/
void reset_al_counter(void) {
        nrf_timer_task_trigger(TIMER_AL_INST, NRF_TIMER_TASK_CLEAR);
        ble_al_counter = 0; 
}

void reset_dl_counter(void) {
        nrf_timer_task_trigger(TIMER_DL_INST, NRF_TIMER_TASK_CLEAR);
        ble_dl_counter = 0;
} 

void reset_sramout(void) {
        done_rd_SRAM = 0; 
        sramout_count = 0; 
        memset((void *)sramout_buffer, 0, sizeof(sramout_buffer));
        memset(&ble_sramout_packet, 0, sizeof(ble_sramout_packet));
} 

void reset_dataout(void) {
        dataout_count = 0; 
        dataout_buffer = 0; 
        rtc_overflow_count = 0; 
        start_timestamp_rtc(); 
} 

/* AL/DL Update Functions ------------------------------------------------------------------*/
void update_al_counter(void) {
        nrf_timer_task_trigger(TIMER_AL_INST, NRF_TIMER_TASK_CAPTURE0);
        ble_al_counter = nrf_timer_cc_get(TIMER_AL_INST, NRF_TIMER_CC_CHANNEL0);
}

void update_dl_counter(void) {
        nrf_timer_task_trigger(TIMER_DL_INST, NRF_TIMER_TASK_CAPTURE0);
        ble_dl_counter = nrf_timer_cc_get(TIMER_DL_INST, NRF_TIMER_CC_CHANNEL0);
}


/* SRAMOUT and DATAOUT Process Functions  ------------------------------------------------------------------*/
bool get_sram_bit(volatile uint32_t *buffer, int bit_idx) {
    // word 0: bits 0-31, word 1: bits 32-63, etc.
    return (buffer[bit_idx >> 5] >> (bit_idx & 31)) & 0x01;
} 

void process_sramout(volatile uint32_t *buffer, int count) {

    //memset(&ble_sramout_packet, 0, sizeof(ble_sramout_packet));

    LOG_INF("sramout: 0x%08X %08X %08X %08X \n", 
         __RBIT(buffer[0]), __RBIT(buffer[1]), __RBIT(buffer[2]), __RBIT(buffer[3]));
    LOG_INF("count: %u \n", count); 

    // --- REPLICATING FPGA LOGIC CONDITIONS ---
    // FPGA: (SRAM_out[0]==1'b1 && counter_SRAM==16'd1)
    if (count == 2 && get_sram_bit(buffer, 0)) {
        done_rd_SRAM = 1;
    }
    // FPGA: (SRAM_out[8]==1'b0 && counter_SRAM==16'd9)
    else if (count == 10 && !get_sram_bit(buffer, 8)) {
        done_rd_SRAM = 1;
    }
    // FPGA: (SRAM_out[110]==1'b0 && counter_SRAM==16'd111)
    // Note: C count 111 is the 112th bit
    else if (count == 112 && !get_sram_bit(buffer, 110)) {
        done_rd_SRAM = 1;
    }

    // buffer[0] has bits that arrived first 
    uint32_t b0 = __RBIT(buffer[0]);
    uint32_t b1 = __RBIT(buffer[1]);
    uint32_t b2 = __RBIT(buffer[2]);
    uint32_t b3 = __RBIT(buffer[3]);

    memset(&ble_sramout_packet, 0, sizeof(ble_sramout_packet));
    if (done_rd_SRAM) {
        // Slice the 128-bit buffer into the 16-bit FPGA chunks
        ble_sramout_packet.SRAM_out6 = (uint16_t)(b0 >> 16);  // bits 0-15 reversed
        ble_sramout_packet.SRAM_out5 = (uint16_t)(b0 & 0xFFFF); // bits 16-31 reversed
        ble_sramout_packet.SRAM_out4 = (uint16_t)(b1 >> 16);  // bits 32-47 reversed
        ble_sramout_packet.SRAM_out3 = (uint16_t)(b1 & 0xFFFF); // bits 48-63 reversed
        ble_sramout_packet.SRAM_out2 = (uint16_t)(b2 >> 16);  // bits 64-79 reversed
        ble_sramout_packet.SRAM_out1 = (uint16_t)(b2 & 0xFFFF); // bits 80-95 reversed
        ble_sramout_packet.SRAM_out0 = (uint16_t)(b3 >> 16);

        bt_gatt_notify(current_conn, &spect_svc.attrs[8], &ble_sramout_packet, sizeof(ble_sramout_packet));
    } 

    done_rd_SRAM = 0; 
    sramout_count = 0; 
    memset((void *)sramout_buffer, 0, sizeof(sramout_buffer));

    LOG_INF("SRAM Data (LSB-Packed): \n");
    LOG_INF("sram_out6 :   0x%04X \n", ble_sramout_packet.SRAM_out6);
    LOG_INF("sram_out5:  0x%04X \n", ble_sramout_packet.SRAM_out5);
    LOG_INF("sram_out4:  0x%04X \n", ble_sramout_packet.SRAM_out4);
    LOG_INF("sram_out3: (96-111): 0x%04X \n", ble_sramout_packet.SRAM_out3);
    LOG_INF("sram_out2 :   0x%04X \n", ble_sramout_packet.SRAM_out2);
    LOG_INF("sram_out1:  0x%04X \n", ble_sramout_packet.SRAM_out1);
    LOG_INF("sram_out0:  0x%04X \n", ble_sramout_packet.SRAM_out0);
    LOG_INF("Total Bits: %d \n", sramout_count);
 
} 


int ble_notification_dataout(struct dataout_ble_packet *pkt, uint16_t len) {
        return bt_gatt_notify(current_conn, &spect_svc.attrs[15], pkt, len); 
}

void process_dataout(uint32_t dataout, int count, uint64_t timestamp) {
    // FPGA: counter_data0 == 16'd25 (which is the 26th bit)

    if (count == 26) {
        struct dataout_ble_packet new_pkt; 

        new_pkt.timestamp = timestamp; 
        
        // Extract the 26 bits. 
        // Note: dataout_buffer[25:0] matches your uint32_t bits 0 to 25.
        new_pkt.dataout = __RBIT(dataout) >> 6; // Mask only 26 bits

        // If you want to send this to your BLE FIFO:
        k_msgq_put(&fifo_data_out, &new_pkt, K_NO_WAIT);
        dataout_count = 0; 
        dataout_buffer = 0;

        uint32_t num_fifo = k_msgq_num_used_get(&fifo_data_out);
        if (num_fifo >= 5) {
                struct dataout_ble_packet send_pkt;
                for (int i = 0; i < 5; i++) {
                        k_msgq_get(&fifo_data_out, &send_pkt, K_NO_WAIT); 
                        int err = ble_notification_dataout(&send_pkt, sizeof(send_pkt)); 
                        if (err) LOG_ERR("dataout sending failed"); 
                }
        }
        
        LOG_INF("DataOut Packet Processed: 0x%08X", new_pkt.dataout);
    } else {
        // This handles cases where noise or partial packets occur
        LOG_WRN("DataOut rejected: count was %d, expected 26", count);
    }
}
```

## src/inputs.h
```c
/**
 * @file inputs.h
 * @author Archie Lee
 * @brief Header file for data interface between nrf52840 inputs and ASIC.
 * @details Defines the public structures and function prototypes for 
 * SRAMOUT, DATAOUT, AL, and DL.
 * @version 1.0
 * @date 2026-01-23
 */

#ifndef INPUTS_H
#define INPUTS_H

#ifdef __cplusplus
extern "C" {
#endif

/* --- Function Prototypes --- */

/** @brief Initializes GPIOTE and EGU for high-speed input sampling. */
void gpiote_inputs_init(void);

/** @brief Initializes timers used for sampling timeouts. */
void timer_timeout_init(void);

/** @brief Configures PPI to link GPIOTE events to Timer/EGU tasks. */
void ppi_inputs_init(void);

/** @brief Initializes timers used as counters (sampling AL/DL). */
void timer_counter_init(void);

/** @brief Resets AL counter. */
void reset_al_counter(void);

/** @brief Resets DL counter. */
void reset_dl_counter(void);

/** @brief Resets sramout. */
void reset_sramout(void);

/** @brief Resets dataout. */
void reset_dataout(void);

/** @brief Updates AL counter value. */
void update_al_counter(void);

/** @brief Updates DL counter value. */
void update_dl_counter(void);

/** @brief Processes sramout data. */
void process_sramout(volatile uint32_t *buffer, int count); 

/** @brief Processes dataout data. */
void process_dataout(uint32_t dataout, int count, uint64_t timestamp); 

/** @brief Returns sramout bit. */
bool get_sram_bit(volatile uint32_t *buffer, int bit_idx); 

#ifdef __cplusplus
}
#endif

#endif /* INPUTS_H */
```

## src/outputs.c
```c
/**
 * @file outputs.c
 * @author Archie Lee
 * @brief Handles data interface between nrf52840 inputs and ASIC. 
 * @details Implements SIPO, DAC I2C outputs, Base clock, 1MHz clock, and Chip reset.  
 * @version 1.0
 * @date 2026-01-23
 */

/* Includes ------------------------------------------------------------------*/
#include "final_patch.h" 

LOG_MODULE_DECLARE(final_patch, LOG_LEVEL_INF);

/* Interrupt Handlers ------------------------------------------------------------------*/ 
static void pwm_sipo_handler(nrfx_pwm_evt_type_t event_type, void * p_context) {
    if (event_type == NRFX_PWM_EVT_FINISHED) {
        sipo_done = true; 
    }
}

/* Peripheral Initializations ------------------------------------------------------------------*/
void pwm_sipo_init(void) {
        nrfx_err_t status;
        (void)status; 

        // sipo config 
        nrfx_pwm_config_t pwm_sipo_config = NRFX_PWM_DEFAULT_CONFIG(SIPO_CLK_OUT, NRF_PWM_PIN_NOT_CONNECTED, SIPO_DATA_OUT, NRF_PWM_PIN_NOT_CONNECTED);
        pwm_sipo_config.base_clock = NRF_PWM_CLK_16MHz; 
        pwm_sipo_config.top_value = 32; 
        pwm_sipo_config.load_mode = NRF_PWM_LOAD_GROUPED;

        // enable sipo pwm interupt 
        IRQ_CONNECT(NRFX_IRQ_NUMBER_GET(NRF_PWM_INST_GET(PWM_SIPO_INST_IDX)), IRQ_PRIO_LOWEST,
                NRFX_PWM_INST_HANDLER_GET(PWM_SIPO_INST_IDX), 0, 0);


        status = nrfx_pwm_init(&pwm_sipo_instance, &pwm_sipo_config, pwm_sipo_handler, NULL);
        NRFX_ASSERT(status == NRFX_SUCCESS);

        nrf_pwm_int_enable(NRF_PWM1, NRF_PWM_INT_SEQEND0_MASK | NRF_PWM_INT_STOPPED_MASK);

        nrf_pwm_shorts_set(NRF_PWM1, NRF_PWM_SHORT_SEQEND0_STOP_MASK);
} 

void pwm_clk_1mhz_init(void) {
        nrfx_err_t status;
        (void)status;

        // sipo config 
        nrfx_pwm_config_t pwm_clk_1mhz_config = NRFX_PWM_DEFAULT_CONFIG(CLK_1MHZ_OUT, NRF_PWM_PIN_NOT_CONNECTED, NRF_PWM_PIN_NOT_CONNECTED, NRF_PWM_PIN_NOT_CONNECTED);
        pwm_clk_1mhz_config.base_clock = NRF_PWM_CLK_16MHz; 
        pwm_clk_1mhz_config.top_value = 16; 
        pwm_clk_1mhz_config.load_mode = NRF_PWM_LOAD_COMMON;

        status = nrfx_pwm_init(&pwm_clk_1mhz_instance, &pwm_clk_1mhz_config, NULL, NULL);
        NRFX_ASSERT(status == NRFX_SUCCESS);

}

void pwm_clk_base_init(void) {
        nrfx_err_t status;
        (void)status;

        // sipo config 
        nrfx_pwm_config_t pwm_clk_base_config = NRFX_PWM_DEFAULT_CONFIG(CLK_BASE_OUT, NRF_PWM_PIN_NOT_CONNECTED, NRF_PWM_PIN_NOT_CONNECTED, NRF_PWM_PIN_NOT_CONNECTED);
        pwm_clk_base_config.base_clock = NRF_PWM_CLK_16MHz; 
        pwm_clk_base_config.top_value = 6400;  // 4176
        pwm_clk_base_config.load_mode = NRF_PWM_LOAD_COMMON;

        status = nrfx_pwm_init(&pwm_clk_base_instance, &pwm_clk_base_config, NULL, NULL);
        NRFX_ASSERT(status == NRFX_SUCCESS);
    
}

void ppi_outputs_init(void) {

    nrf_gpio_cfg(
                CLK_BASE_OUT,
                NRF_GPIO_PIN_DIR_OUTPUT,
                NRF_GPIO_PIN_INPUT_CONNECT,
                NRF_GPIO_PIN_NOPULL,
                NRF_GPIO_PIN_S0S1,
                NRF_GPIO_PIN_NOSENSE);

    nrf_gpiote_event_configure(NRF_GPIOTE, GPIOTE_BASE_CLK_CH, CLK_BASE_OUT, NRF_GPIOTE_POLARITY_LOTOHI);

    nrf_ppi_channel_endpoint_setup(NRF_PPI, PPI_SIPO_CH, 
        nrf_gpiote_event_address_get(NRF_GPIOTE, NRF_GPIOTE_EVENT_IN_0), 
        nrf_pwm_task_address_get(NRF_PWM1, NRF_PWM_TASK_SEQSTART1)
    ); 

    nrf_ppi_fork_endpoint_setup(NRF_PPI, PPI_SIPO_CH, 
        (uint32_t)&NRF_PPI->TASKS_CHG[PPI_SIPO_CH].DIS);

    nrf_ppi_channel_endpoint_setup(NRF_PPI, PPI_CLK_1MHZ_CH, 
        nrf_gpiote_event_address_get(NRF_GPIOTE, NRF_GPIOTE_EVENT_IN_0), 
        nrf_pwm_task_address_get(NRF_PWM2, NRF_PWM_TASK_SEQSTART1)
    ); 

    nrf_ppi_fork_endpoint_setup(NRF_PPI, PPI_CLK_1MHZ_CH, 
        (uint32_t)&NRF_PPI->TASKS_CHG[PPI_CLK_1MHZ_CH].DIS);

    nrf_gpiote_event_enable(NRF_GPIOTE, GPIOTE_BASE_CLK_CH);
    
}

/* Output Initializations ------------------------------------------------------------------*/
void dac_init(void) {
    nrf_gpio_cfg_output(DAC_SDA_PIN); 
    nrf_gpio_cfg_output(DAC_SCL_PIN);
    __DSB();
    nrf_gpio_pin_set(DAC_SDA_PIN); 
    __DSB(); 
    k_busy_wait(5); 
    nrf_gpio_pin_set(DAC_SCL_PIN);
    dac_i2c_done = false;
    done_wr_dac = 0;
}

/* Output Resets ------------------------------------------------------------------*/ 
void dac_reset(void) {    
    nrf_gpio_pin_set(DAC_SDA_PIN); 
    __DSB(); 
    k_busy_wait(5); 
    nrf_gpio_pin_set(DAC_SCL_PIN);
    dac_i2c_done = false; 
    done_wr_dac = 0;
}

void sipo_reset(void) {    
    done_wr_sipo = 0; 
    sipo_done = false;
}


/* Outputs Transfer Functions ------------------------------------------------------------------*/
void dac_i2c_write(const uint8_t *data, uint16_t len) 
{   
    LOG_INF("DAC transfer");
    if (len < 5) {
        LOG_ERR("DAC data too short"); 
        return; 
    }
    LOG_INF("DAC transfer start"); 
    // 1. Concatenate data exactly like: {dac2, dac1, dac0[15:12]}
    // We use a 64-bit int to hold the 36-bit result comfortably
    uint64_t dac_main = 0;

    dac_main = ((uint64_t)data[0] << 28) |
               ((uint64_t)data[1] << 20) |
               ((uint64_t)data[2] << 12) |
               ((uint64_t)data[3] << 4)  |
               ((uint64_t)(data[4] >> 4) & 0x0F);

    // define critical section
    unsigned int i2c_key = irq_lock();

    // STATE 0: Idle/Trigger
    // In Verilog: next_dac_data_bit = 1'b0 (Start condition)
    nrf_gpio_pin_clear(DAC_SDA_PIN); 
    k_busy_wait(5); 
    nrf_gpio_pin_clear(DAC_SCL_PIN); 

    // STATE 1: Shifting 36 bits
    // counter_dac starts at 6'b100100 (36 decimal)
    for (int i = 35; i >= 0; i--) {   
        // set data bit 
        nrf_gpio_pin_write(DAC_SDA_PIN, (dac_main >> i) & 0x01); 

        // clock high 
        k_busy_wait(5); 
        nrf_gpio_pin_set(DAC_SCL_PIN); 

        // clock low 
        k_busy_wait(5); 
        nrf_gpio_pin_clear(DAC_SCL_PIN); 
    }

    // Wrap up / Reset State
    // In Verilog: next_dac_clk = 1'b1, next_dac_data_bit = 1'b1
    k_busy_wait(5); 
    nrf_gpio_pin_set(DAC_SCL_PIN); 
    k_busy_wait(5); 
    nrf_gpio_pin_set(DAC_SDA_PIN); 


    irq_unlock(i2c_key);
    
    LOG_INF("DAC Transaction Complete: 0x%09llX", dac_main);
    dac_i2c_done = true; 
} 

/* sipo functions */
void prepare_sipo_buffer(const uint8_t *sipo_data) {
        //uint32_t data_value = 0x88888; 

        // uint8_t data_value[16] = {
        //     0xAA, 0xAA, 0xAA, 0xAA, // Bytes 0-3  (101010...)
        //     0x55, 0x55, 0x55, 0x55, // Bytes 4-7  (010101...)
        //     0xFF, 0xFF, 0x00, 0x00, // Bytes 8-11 (Solid High then Solid Low)
        //     0x12, 0x34, 0x56, 0x78  // Bytes 12-15 (Random Pattern)
        // };

        for (uint8_t i = 0; i < SIPO_DATA_LEN; i++) {
                // Extract bit from MSB down to LSB
                //bool bit = (data_value >> (20 - 1 - i)) & 0x01;

                // 1. Calculate which byte we are in (0 to 15)
                int byte_idx = i / 8;
                
                // 2. Calculate which bit inside that byte (7 down to 0 for MSB-first)
                int bit_idx = 7 - (i % 8);

                // 3. Extract the bit
                bool bit = (sipo_data[byte_idx] >> bit_idx) & 0x01;

                /// Data:
                if (!bit) {
                        // Force "Always High" by setting duty cycle > top_value
                        // This prevents the PWM counter from ever "resetting" the pin
                        sipo_buffer[i].group_1 = 0x8000; 
                } else {
                        sipo_buffer[i].group_1 = 0;  
                }

                sipo_buffer[i].group_0 = 16;
        }
}

void sipo_trigger_transfer(void) {
    nrf_pwm_task_trigger(NRF_PWM1, NRF_PWM_TASK_STOP);
    k_busy_wait(10);

    nrfx_pwm_simple_playback(&pwm_sipo_instance, &seq_sipo, 1, NRFX_PWM_FLAG_STOP | NRFX_PWM_FLAG_START_VIA_TASK);
    nrf_ppi_channel_enable(NRF_PPI, PPI_SIPO_CH);
    LOG_INF("PPI channel enabled"); 
}

/* start global clock */
void clk_1mhz_trigger_transfer(void) {
        nrfx_pwm_simple_playback(&pwm_clk_1mhz_instance, &seq_clk_1mhz, 1, NRFX_PWM_FLAG_LOOP | NRFX_PWM_FLAG_START_VIA_TASK);
        nrf_ppi_channel_enable(NRF_PPI, PPI_CLK_1MHZ_CH);
}

void clk_base_trigger_transfer(void) {
        nrfx_pwm_simple_playback(&pwm_clk_base_instance, &seq_clk_base, 1, NRFX_PWM_FLAG_LOOP);
}

void chip_reset(void) {
    unsigned int ch_rst_key = irq_lock();

    nrf_gpio_pin_clear(CH_RST);
    nrf_gpio_pin_set(CH_RST); 

    // high for 1kHz
    k_busy_wait(1000);

    nrf_gpio_pin_clear(CH_RST);

    irq_unlock(ch_rst_key);
}
```

## src/outputs.h
```c
/**
 * @file outputs.h
 * @author Archie Lee
 * @brief Header file for data interface between nrf52840 outputs and ASIC.
 * @details Defines the public structures and function prototypes for 
 * SIPO, DAC I2C, Base clock, 1MHz clock, and Chip reset.
 * @version 1.0
 * @date 2026-01-23
 */

#ifndef OUTPUTS_H
#define OUTPUTS_H

#ifdef __cplusplus
extern "C" {
#endif

/* --- Function Prototypes --- */

/**
 * @brief Initializes the PWM for SIPO data transmission.
 * Configures grouped load mode and connects the IRQ handler.
 */
void pwm_sipo_init(void);

/**
 * @brief Initializes a 1MHz clock source using a PWM instance.
 */
void pwm_clk_1mhz_init(void);

/**
 * @brief Initializes the base reference clock for the system.
 */
void pwm_clk_base_init(void);

/**
 * @brief Initializes the DAC I2C interface to an idle state.
 */
void dac_init(void);

/**
 * @brief Resets the DAC I2C interface to an idle state.
 */
void dac_reset(void);

/**
 * @brief Resets the SIPO interface to an idle state.
 */
void sipo_reset(void); 

/**
 * @brief Bit-bangs 36 bits of data to the I2C DAC.
 * @param dac2 Top 16 bits
 * @param dac1 Middle 16 bits
 * @param dac0 Bottom 16 bits (shifts to use MSB 4 bits)
 */
void dac_i2c_write(const uint8_t *data, uint16_t len);

/**
 * @brief Configures PPI and GPIOTE to link clock events to PWM tasks.
 */
void ppi_outputs_init(void);

/**
 * @brief Fills the SIPO buffer with test patterns or specific data.
 */
void prepare_sipo_buffer(const uint8_t *sipo_data);  

/**
 * @brief Enables PPI and triggers the SIPO data playback.
 */
void sipo_trigger_transfer(void);

/**
 * @brief Starts the 1MHz clock output.
 */
void clk_1mhz_trigger_transfer(void);

/**
 * @brief Starts the base reference clock output.
 */
void clk_base_trigger_transfer(void);

/**
 * @brief Resets the chip.
 */
void chip_reset(void); 

#ifdef __cplusplus
}
#endif

#endif /* OUTPUTS_H */
```

## src/rtc.h
```c
/**
 * @file rtc.h
 * @author Archie Lee
 * @brief  Header file for RTC timer logic for dataout timestamp. 
 * @details Defines RTC timer initialization, RTC timer handler, and timestamp return.  
 * @version 1.0
 * @date 2026-02-03
 */

#ifndef RTC_H
#define RTC_H


/* --- Function Prototypes --- */

/**
 * @brief Begins timestamp timer for dataout.
 */
void start_timestamp_rtc(void); 

/**
 * @brief Returns timestamp for dataout.
 */
uint64_t get_current_timestamp(void);

#endif /* FINAL_PATCH_H */
```
