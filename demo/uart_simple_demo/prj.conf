## CMakeLists.txt
```
cmake_minimum_required(VERSION 3.20.0)
set(BOARD adafruit_feather_nrf52840) # added 

find_package(Zephyr REQUIRED HINTS $ENV{ZEPHYR_BASE})

project(uart_simple_demo)

target_sources(app PRIVATE src/main.c)
```

## prj.conf
```kconfig
# CONFIG_SERIAL=y
# CONFIG_UART_CONSOLE=y
# CONFIG_UART_INTERRUPT_DRIVEN=y


# CONFIG_USB_DEVICE_VID=0x1915
# CONFIG_USB_DEVICE_PID=0x521F

CONFIG_USB_DEVICE_STACK=y
CONFIG_USB_DEVICE_PRODUCT="MyUSBDevice"

CONFIG_USB_CDC_ACM=y
CONFIG_UART_LINE_CTRL=y
CONFIG_SERIAL=y
CONFIG_MAIN_STACK_SIZE=2048
```

## src/main.c
```c
#include <zephyr/kernel.h>
#include <zephyr/device.h>
#include <zephyr/drivers/uart.h>
#include <zephyr/usb/usb_device.h>
#include <zephyr/sys/printk.h> 

static const struct device *uart;

// receive data
static uint8_t foo;

static bool tx_pending; 

/* UART ISR callback */
static void uart_cb(const struct device *dev, void *user_data)
{
    // prepare for ready functions 
    if (!uart_irq_update(dev)) return; 

    if (uart_irq_rx_ready(dev)) {

        int len = uart_fifo_read(dev, &foo,  1);
        if (len > 0) {
            foo++; 
            uart_irq_tx_enable(dev);
            tx_pending = true; 
        }
    }

    /* Return back to the terminal */
    if (uart_irq_tx_ready(dev)) {
        uart_fifo_fill(dev, &foo, 1);
        tx_pending = false; 
        uart_irq_tx_disable(dev);
    }
}

int main(void)
{
    int ret;

    // declare usb device node 
    uart = DEVICE_DT_GET(DT_NODELABEL(cdc_acm)); 
    if (!device_is_ready(uart)) {
        printk("CDC ACM not ready\n");
        return 0;
    }

    /* Enable USB serial */
    ret = usb_enable(NULL); 
    if (ret) {
        printk("USB init failed: %d\n", ret);
        return 0;
    }

    // data terminal ready: control signal sent by the pc to say that it is ready 
    int dtr = 0;  
    while (!dtr) {
        uart_line_ctrl_get(uart, UART_LINE_CTRL_DTR, &dtr); 
        k_msleep(10);
    }

   // set callback function 
   uart_irq_callback_user_data_set(uart, uart_cb, &foo);

   // enable uart rx interrupt 
   uart_irq_rx_enable(uart); 

   while (1) {
    k_sleep(K_FOREVER); 
   }

}
```

## src/main copy.c
```c
#include <zephyr/kernel.h>
#include <zephyr/device.h>
#include <zephyr/drivers/uart.h>
#include <zephyr/usb/usb_device.h>
#include <zephyr/sys/printk.h>

static const struct device *uart;

/* UART ISR callback */
static void uart_cb(const struct device *dev, void *user_data)
{
    uint8_t c;

    while (uart_irq_update(dev) && uart_irq_rx_ready(dev)) {

        int len = uart_fifo_read(dev, &c, 1);
        if (len > 0) {
            printk("Received: %c\n", c);

            /* Echo back to terminal */
            uart_fifo_fill(dev, &c, 1);

            /* Test command */
            if (c == 'h') {
                char msg[] = "hello!\r\n";
                uart_fifo_fill(dev, msg, strlen(msg));
            }
        }
    }
}

int main(void)
{
    int ret;

    /* Enable USB serial */
    ret = usb_enable(NULL); 
    if (ret) {
        printk("USB init failed: %d\n", ret);
        return 0;
    }

    k_sleep(K_MSEC(300));

    uart = DEVICE_DT_GET(DT_NODELABEL(cdc_acm)); 

    if (!device_is_ready(uart)) {
        printk("CDC ACM not ready\n");
        return 0;
    }

    /* Wait for macOS terminal to open tty.usbmodemXXX */
    uint32_t dtr = 0; 
    while (uart_line_ctrl_get(uart, UART_LINE_CTRL_DTR, &dtr) == 0) {
        if (dtr) break;
        k_sleep(K_MSEC(100));
    }

    printk("Host connected.\n");

    /* Enable UART interrupt mode */
    uart_irq_callback_user_data_set(uart, uart_cb, NULL);
    uart_irq_rx_enable(uart);

    /* Send a startup message */
    char msg[] = "Connected. Type something:\r\n";
    uart_fifo_fill(uart, msg, strlen(msg));

    while (1) {
        k_sleep(K_SECONDS(1));
    }
}
```
